## configs/ap-hw25b_defconfig
```kconfig
BR2_aarch64=y
BR2_DL_DIR="$(BASE_DIR)/dl"
BR2_TOOLCHAIN_BUILDROOT_VENDOR="tesla"
BR2_TOOLCHAIN_BUILDROOT_GLIBC=y
BR2_KERNEL_HEADERS_4_14=y
BR2_TARGET_GENERIC_HOSTNAME="ap-b"
BR2_TARGET_GENERIC_ISSUE="Autopilot ]["
BR2_INIT_NONE=y
# BR2_TARGET_GENERIC_GETTY is not set
BR2_PACKAGE_BUSYBOX_SHOW_OTHERS=y
BR2_PACKAGE_IPUTILS=y
BR2_PACKAGE_OPENSSH=y
BR2_TARGET_ROOTFS_CPIO=y
BR2_TARGET_ROOTFS_CPIO_XZ=y
# BR2_TARGET_ROOTFS_TAR is not set
```

## configs/ap-hw2_defconfig
```kconfig
BR2_aarch64=y
BR2_DL_DIR="$(BASE_DIR)/dl"
BR2_ENABLE_DEBUG=y
BR2_TOOLCHAIN_BUILDROOT_VENDOR="tesla"
BR2_TOOLCHAIN_BUILDROOT_GLIBC=y
BR2_KERNEL_HEADERS_4_14=y
BR2_TOOLCHAIN_BUILDROOT_CXX=y
BR2_TOOLCHAIN_BUILDROOT_FORTRAN=y
BR2_TARGET_OPTIMIZATION="-g2"
BR2_TARGET_GENERIC_HOSTNAME="ap"
BR2_TARGET_GENERIC_ISSUE="Autopilot ]["
BR2_INIT_NONE=y
BR2_ROOTFS_DEVICE_CREATION_DYNAMIC_EUDEV=y
BR2_TARGET_TZ_INFO=y
BR2_TARGET_LOCALTIME="America/Los_Angeles"
BR2_LINUX_KERNEL=y
BR2_LINUX_KERNEL_CUSTOM_GIT=y
BR2_LINUX_KERNEL_CUSTOM_REPO_URL="https://github.com/teslamotors/linux.git"
BR2_LINUX_KERNEL_CUSTOM_REPO_VERSION="ea93e1a541bbcefa644348b685a6c067a509c63e"
BR2_LINUX_KERNEL_DEFCONFIG="ap-hw2"
BR2_LINUX_KERNEL_LZMA=y
BR2_LINUX_KERNEL_DTS_SUPPORT=y
BR2_LINUX_KERNEL_INTREE_DTS_NAME="tegra186-tesla-das-hw20-rev-c tegra186-tesla-das-hw25a tegra186-tesla-das-hw25b"
BR2_LINUX_KERNEL_EXT_INITRAMFS=y
BR2_LINUX_KERNEL_EXT_INITRAMFS_LOCATION="initramfs.cpio.xz"
BR2_LINUX_KERNEL_EXT_INITRAMFS_PKG="linux-initramfs"
BR2_PACKAGE_LINUX_TOOLS_PERF=y
BR2_PACKAGE_BUSYBOX_SHOW_OTHERS=y
BR2_PACKAGE_ALSA_UTILS=y
# BR2_PACKAGE_ALSA_UTILS_ALSAMIXER is not set
BR2_PACKAGE_ALSA_UTILS_AMIXER=y
BR2_PACKAGE_ALSA_UTILS_APLAY=y
BR2_PACKAGE_ALSA_UTILS_SPEAKER_TEST=y
BR2_PACKAGE_LZ4=y
BR2_PACKAGE_STRACE=y
BR2_PACKAGE_TRACE_CMD=y
BR2_PACKAGE_JQ=y
BR2_PACKAGE_E2FSPROGS=y
# BR2_PACKAGE_E2FSPROGS_FSCK is not set
BR2_PACKAGE_E2FSPROGS_RESIZE2FS=y
BR2_PACKAGE_CRYPTSETUP=y
BR2_PACKAGE_DBUS=y
BR2_PACKAGE_I2C_TOOLS=y
BR2_PACKAGE_LSHW=y
BR2_PACKAGE_PCIUTILS=y
BR2_PACKAGE_USBUTILS=y
BR2_PACKAGE_LUA=y
BR2_PACKAGE_LIBARCHIVE=y
BR2_PACKAGE_LIBSODIUM=y
BR2_PACKAGE_LIBOPENSSL_BIN=y
BR2_PACKAGE_LIBOPENSSL_ENGINES=y
BR2_PACKAGE_SQLITE=y
BR2_PACKAGE_SQLITE_RTREE=y
BR2_PACKAGE_SQLITE_MEMSYS5=y
BR2_PACKAGE_LIBSYSFS=y
BR2_PACKAGE_RAPIDJSON=y
BR2_PACKAGE_GLOG=y
BR2_PACKAGE_METIS=y
BR2_PACKAGE_CERES_SOLVER=y
BR2_PACKAGE_SUITESPARSE=y
BR2_PACKAGE_LIBCURL=y
BR2_PACKAGE_CURL=y
BR2_PACKAGE_LIBMNL=y
BR2_PACKAGE_LIBWEBSOCKETS=y
BR2_PACKAGE_WEBSOCKETPP=y
BR2_PACKAGE_APR=y
BR2_PACKAGE_BOOST=y
BR2_PACKAGE_BOOST_ATOMIC=y
BR2_PACKAGE_BOOST_CONTAINER=y
BR2_PACKAGE_BOOST_DATE_TIME=y
BR2_PACKAGE_BOOST_FILESYSTEM=y
BR2_PACKAGE_BOOST_IOSTREAMS=y
BR2_PACKAGE_BOOST_PROGRAM_OPTIONS=y
BR2_PACKAGE_BOOST_REGEX=y
BR2_PACKAGE_BOOST_THREAD=y
BR2_PACKAGE_EIGEN=y
BR2_PACKAGE_EIGEN_UNSUPPORTED_MODULES=y
BR2_PACKAGE_GFLAGS=y
BR2_PACKAGE_LIBCAP_TOOLS=y
BR2_PACKAGE_LIBFFI=y
BR2_PACKAGE_LIBNIH=y
BR2_PACKAGE_OPENBLAS_TARGET="CORTEXA57"
BR2_PACKAGE_PROTOBUF=y
BR2_PACKAGE_PROTOBUF_C=y
BR2_PACKAGE_READLINE=y
BR2_PACKAGE_SLANG=y
BR2_PACKAGE_IFUPDOWN=y
BR2_PACKAGE_IPROUTE2=y
BR2_PACKAGE_IPTABLES=y
BR2_PACKAGE_IPUTILS=y
BR2_PACKAGE_NTP=y
# BR2_PACKAGE_NTP_NTPD is not set
BR2_PACKAGE_NTP_NTPDATE=y
BR2_PACKAGE_OPENSSH=y
BR2_PACKAGE_KMOD_TOOLS=y
BR2_PACKAGE_PROCPS_NG=y
BR2_PACKAGE_UTIL_LINUX_BINARIES=y
BR2_PACKAGE_UTIL_LINUX_LOGGER=y
BR2_PACKAGE_UTIL_LINUX_MOUNT=y
BR2_PACKAGE_UTIL_LINUX_SCHEDUTILS=y
BR2_PACKAGE_UTIL_LINUX_WALL=y
BR2_PACKAGE_AP_GOOGLE_BREAKPAD=y
BR2_PACKAGE_LIBBACKTRACE=y
BR2_PACKAGE_LINUX_INITRAMFS=y
BR2_PACKAGE_LINUX_INITRAMFS_TARGET="ap-hw2i_defconfig"
BR2_PACKAGE_MINIJAIL=y
BR2_PACKAGE_PROTOBUF3=y
BR2_PACKAGE_RUNIT=y
BR2_PACKAGE_TESLA_FINDUTILS=y
BR2_PACKAGE_TESLA_NANOMSG=y
BR2_TARGET_ROOTFS_SQUASHFS=y
# BR2_TARGET_ROOTFS_TAR is not set
BR2_PACKAGE_HOST_CHECKSEC=y
BR2_PACKAGE_HOST_CRYPTSETUP=y
BR2_PACKAGE_HOST_JQ=y
```

## configs/ap-hw3_defconfig
```kconfig
BR2_aarch64=y
BR2_DL_DIR="$(BASE_DIR)/dl"
BR2_ENABLE_DEBUG=y
BR2_TOOLCHAIN_BUILDROOT_VENDOR="tesla"
BR2_TOOLCHAIN_BUILDROOT_GLIBC=y
BR2_KERNEL_HEADERS_4_14=y
BR2_TOOLCHAIN_BUILDROOT_CXX=y
BR2_TOOLCHAIN_BUILDROOT_FORTRAN=y
BR2_TARGET_OPTIMIZATION="-g2"
BR2_TARGET_GENERIC_HOSTNAME="ap3"
BR2_TARGET_GENERIC_ISSUE="Autopilot ///"
BR2_INIT_NONE=y
BR2_ROOTFS_DEVICE_CREATION_DYNAMIC_EUDEV=y
BR2_TARGET_TZ_INFO=y
BR2_TARGET_LOCALTIME="America/Los_Angeles"
BR2_LINUX_KERNEL=y
BR2_LINUX_KERNEL_CUSTOM_GIT=y
BR2_LINUX_KERNEL_CUSTOM_REPO_URL="https://github.com/teslamotors/linux.git"
BR2_LINUX_KERNEL_CUSTOM_REPO_VERSION="31b65cbdceebb35e38a3b25743c25548d594191e"
BR2_LINUX_KERNEL_SHOW_EXTRA_KERNEL_VERSION=y
BR2_LINUX_KERNEL_DEFCONFIG="board-rev0"
BR2_LINUX_KERNEL_DTS_SUPPORT=y
BR2_LINUX_KERNEL_INTREE_DTS_NAME="turbo/turbo-trav-board-hw31 turbo/turbo-trav-board-rev-b0"
BR2_LINUX_KERNEL_EXT_INITRAMFS=y
BR2_LINUX_KERNEL_EXT_INITRAMFS_LOCATION="initramfs.cpio.xz"
BR2_LINUX_KERNEL_EXT_INITRAMFS_PKG="linux-initramfs"
BR2_PACKAGE_LINUX_TOOLS_PCI=y
BR2_PACKAGE_LINUX_TOOLS_PERF=y
BR2_PACKAGE_BUSYBOX_SHOW_OTHERS=y
BR2_PACKAGE_ALSA_UTILS=y
BR2_PACKAGE_ALSA_UTILS_AMIXER=y
BR2_PACKAGE_ALSA_UTILS_APLAY=y
BR2_PACKAGE_ALSA_UTILS_SPEAKER_TEST=y
BR2_PACKAGE_GSTREAMER1=y
BR2_PACKAGE_GST1_PLUGINS_BASE_PLUGIN_APP=y
BR2_PACKAGE_GST1_PLUGINS_BASE_PLUGIN_ENCODING=y
BR2_PACKAGE_GST1_PLUGINS_BASE_PLUGIN_VIDEOCONVERT=y
BR2_PACKAGE_GST1_PLUGINS_BASE_PLUGIN_TCP=y
BR2_PACKAGE_GST1_PLUGINS_BASE_PLUGIN_VIDEOTESTSRC=y
BR2_PACKAGE_GST1_PLUGINS_BASE_PLUGIN_VIDEORATE=y
BR2_PACKAGE_GST1_PLUGINS_GOOD=y
BR2_PACKAGE_GST1_PLUGINS_GOOD_PLUGIN_AUTODETECT=y
BR2_PACKAGE_GST1_PLUGINS_GOOD_PLUGIN_DEBUGUTILS=y
BR2_PACKAGE_GST1_PLUGINS_GOOD_PLUGIN_RTP=y
BR2_PACKAGE_GST1_PLUGINS_GOOD_PLUGIN_RTPMANAGER=y
BR2_PACKAGE_GST1_PLUGINS_GOOD_PLUGIN_UDP=y
BR2_PACKAGE_GST1_PLUGINS_GOOD_PLUGIN_VIDEOCROP=y
BR2_PACKAGE_GST1_PLUGINS_GOOD_PLUGIN_V4L2=y
BR2_PACKAGE_GST1_PLUGINS_BAD=y
BR2_PACKAGE_GST1_PLUGINS_BAD_PLUGIN_VIDEOPARSERS=y
BR2_PACKAGE_GST1_LIBAV=y
BR2_PACKAGE_V4L2GRAB=y
BR2_PACKAGE_YAVTA=y
BR2_PACKAGE_LZ4=y
BR2_PACKAGE_XZ=y
BR2_PACKAGE_ZIP=y
BR2_PACKAGE_MEMSTAT=y
BR2_PACKAGE_STRACE=y
BR2_PACKAGE_TRACE_CMD=y
BR2_PACKAGE_JQ=y
# BR2_PACKAGE_E2FSPROGS_FSCK is not set
BR2_PACKAGE_E2FSPROGS_RESIZE2FS=y
BR2_PACKAGE_E2TOOLS=y
BR2_PACKAGE_CRYPTSETUP=y
BR2_PACKAGE_DBUS=y
BR2_PACKAGE_I2C_TOOLS=y
BR2_PACKAGE_IOSTAT=y
BR2_PACKAGE_MEMTESTER=y
BR2_PACKAGE_PCIUTILS=y
BR2_PACKAGE_SETSERIAL=y
BR2_PACKAGE_SG3_UTILS=y
BR2_PACKAGE_SYSSTAT=y
BR2_PACKAGE_USBUTILS=y
BR2_PACKAGE_LUA=y
BR2_PACKAGE_LIBARCHIVE=y
BR2_PACKAGE_LZO=y
BR2_PACKAGE_LIBSODIUM=y
BR2_PACKAGE_MBEDTLS=y
BR2_PACKAGE_LIBOPENSSL_BIN=y
BR2_PACKAGE_LIBOPENSSL_ENGINES=y
BR2_PACKAGE_SQLITE=y
BR2_PACKAGE_SQLITE_RTREE=y
BR2_PACKAGE_SQLITE_MEMSYS5=y
BR2_PACKAGE_LIBSYSFS=y
BR2_PACKAGE_OPENCV=y
# BR2_PACKAGE_OPENCV_LIB_LEGACY is not set
# BR2_PACKAGE_OPENCV_LIB_STITCHING is not set
# BR2_PACKAGE_OPENCV_LIB_SUPERRES is not set
# BR2_PACKAGE_OPENCV_LIB_TS is not set
# BR2_PACKAGE_OPENCV_LIB_VIDEOSTAB is not set
BR2_PACKAGE_LIBGPIOD=y
BR2_PACKAGE_LIBGPIOD_TOOLS=y
BR2_PACKAGE_LIBV4L_UTILS=y
BR2_PACKAGE_RAPIDJSON=y
BR2_PACKAGE_GLOG=y
BR2_PACKAGE_METIS=y
BR2_PACKAGE_CERES_SOLVER=y
BR2_PACKAGE_SUITESPARSE=y
BR2_PACKAGE_LIBCURL=y
BR2_PACKAGE_CURL=y
BR2_PACKAGE_LIBMNL=y
BR2_PACKAGE_LIBWEBSOCKETS=y
BR2_PACKAGE_WEBSOCKETPP=y
BR2_PACKAGE_APR=y
BR2_PACKAGE_BOOST=y
BR2_PACKAGE_BOOST_ATOMIC=y
BR2_PACKAGE_BOOST_CONTAINER=y
BR2_PACKAGE_BOOST_DATE_TIME=y
BR2_PACKAGE_BOOST_FILESYSTEM=y
BR2_PACKAGE_BOOST_IOSTREAMS=y
BR2_PACKAGE_BOOST_PROGRAM_OPTIONS=y
BR2_PACKAGE_BOOST_REGEX=y
BR2_PACKAGE_BOOST_THREAD=y
BR2_PACKAGE_EIGEN=y
BR2_PACKAGE_EIGEN_UNSUPPORTED_MODULES=y
BR2_PACKAGE_GFLAGS=y
BR2_PACKAGE_LIBNIH=y
BR2_PACKAGE_OPENBLAS_TARGET="CORTEXA57"
BR2_PACKAGE_PROTOBUF=y
BR2_PACKAGE_PROTOBUF_C=y
BR2_PACKAGE_KAFEL=y
BR2_PACKAGE_SLANG=y
BR2_PACKAGE_CAN_UTILS=y
BR2_PACKAGE_ETHTOOL=y
BR2_PACKAGE_IPROUTE2=y
BR2_PACKAGE_IPTABLES=y
BR2_PACKAGE_IPUTILS=y
BR2_PACKAGE_LINUXPTP=y
BR2_PACKAGE_NTP=y
# BR2_PACKAGE_NTP_NTPD is not set
BR2_PACKAGE_NTP_NTPDATE=y
BR2_PACKAGE_OPENSSH=y
BR2_PACKAGE_SOCAT=y
BR2_PACKAGE_TCPDUMP=y
BR2_PACKAGE_PROCPS_NG=y
BR2_PACKAGE_UTIL_LINUX_BINARIES=y
BR2_PACKAGE_UTIL_LINUX_LOGGER=y
BR2_PACKAGE_UTIL_LINUX_MOUNT=y
BR2_PACKAGE_UTIL_LINUX_SCHEDUTILS=y
BR2_PACKAGE_UTIL_LINUX_WALL=y
BR2_PACKAGE_AP_GOOGLE_BREAKPAD=y
BR2_PACKAGE_LIBBACKTRACE=y
BR2_PACKAGE_LINUX_INITRAMFS=y
BR2_PACKAGE_LINUX_INITRAMFS_TARGET="ap-hw3i_defconfig"
BR2_PACKAGE_PROTOBUF3=y
BR2_PACKAGE_RUNIT=y
BR2_PACKAGE_TESLA_FINDUTILS=y
BR2_PACKAGE_TESLA_NANOMSG=y
BR2_TARGET_ROOTFS_SQUASHFS=y
BR2_TARGET_ROOTFS_SQUASHFS4_XZ=y
# BR2_TARGET_ROOTFS_TAR is not set
BR2_PACKAGE_HOST_CRYPTSETUP=y
```

## configs/ap-hw3i_defconfig
```kconfig
BR2_aarch64=y
BR2_DL_DIR="$(BASE_DIR)/dl"
BR2_TOOLCHAIN_BUILDROOT_VENDOR="tesla"
BR2_TOOLCHAIN_BUILDROOT_MUSL=y
BR2_KERNEL_HEADERS_4_14=y
BR2_GCC_VERSION_5_X=y
BR2_ROOTFS_SKELETON_CUSTOM=y
BR2_ROOTFS_SKELETON_CUSTOM_PATH="board/tesla/initramfs_overlay"
BR2_INIT_NONE=y
BR2_ROOTFS_DEVICE_TABLE=""
BR2_ENABLE_LOCALE_WHITELIST="en_US"
BR2_ROOTFS_POST_BUILD_SCRIPT="board/tesla/verity-initramfs-cleanup.sh"
# BR2_PACKAGE_BUSYBOX is not set
BR2_PACKAGE_TESLA_VERITY=y
BR2_PACKAGE_TESLA_VERITY_AP_HW3=y
BR2_TARGET_ROOTFS_CPIO=y
BR2_TARGET_ROOTFS_CPIO_XZ=y
# BR2_TARGET_ROOTFS_TAR is not set
```

## configs/ap-hw3r_defconfig
```kconfig
BR2_aarch64=y
BR2_DL_DIR="$(BASE_DIR)/dl"
BR2_ENABLE_DEBUG=y
BR2_TOOLCHAIN_BUILDROOT_VENDOR="tesla"
BR2_TOOLCHAIN_BUILDROOT_GLIBC=y
BR2_KERNEL_HEADERS_4_14=y
BR2_TARGET_OPTIMIZATION="-g2"
BR2_TARGET_GENERIC_HOSTNAME="ap3r"
BR2_TARGET_GENERIC_ISSUE="Autopilot ///"
BR2_INIT_NONE=y
BR2_LINUX_KERNEL=y
BR2_LINUX_KERNEL_CUSTOM_GIT=y
BR2_LINUX_KERNEL_CUSTOM_REPO_URL="https://github.com/teslamotors/linux.git"
BR2_LINUX_KERNEL_CUSTOM_REPO_VERSION="31b65cbdceebb35e38a3b25743c25548d594191e"
BR2_LINUX_KERNEL_SHOW_EXTRA_KERNEL_VERSION=y
BR2_LINUX_KERNEL_DEFCONFIG="board-rev0"
BR2_LINUX_KERNEL_DTS_SUPPORT=y
BR2_LINUX_KERNEL_INTREE_DTS_NAME="turbo/turbo-trav-board-hw31 turbo/turbo-trav-board-rev-b0"
BR2_PACKAGE_LIBGPIOD=y
BR2_PACKAGE_LIBGPIOD_TOOLS=y
BR2_PACKAGE_IPUTILS=y
BR2_PACKAGE_OPENSSH=y
BR2_PACKAGE_UTIL_LINUX=y
BR2_PACKAGE_UTIL_LINUX_BINARIES=y
BR2_TARGET_ROOTFS_CPIO=y
BR2_TARGET_ROOTFS_CPIO_XZ=y
# BR2_TARGET_ROOTFS_TAR is not set
```

## configs/ice-elk_defconfig
```kconfig
BR2_x86_64=y
BR2_x86_corei7=y
BR2_WGET="wget --passive-ftp --no-verbose -nd -t 3 -4"
BR2_DL_DIR="$(BASE_DIR)/dl"
BR2_TOOLCHAIN_BUILDROOT_VENDOR="tesla"
BR2_TOOLCHAIN_BUILDROOT_MUSL=y
BR2_KERNEL_HEADERS_4_14=y
BR2_TARGET_GENERIC_HOSTNAME="ui"
BR2_TARGET_GENERIC_ISSUE=""
BR2_ENABLE_LOCALE_WHITELIST="en_US"
BR2_LINUX_KERNEL=y
BR2_LINUX_KERNEL_CUSTOM_GIT=y
BR2_LINUX_KERNEL_CUSTOM_REPO_URL="https://github.com/teslamotors/linux.git"
BR2_LINUX_KERNEL_CUSTOM_REPO_VERSION="62a96805af3ed184d57681e3abf438476f5d6c5f"
BR2_LINUX_KERNEL_DEFCONFIG="ice-elk"
BR2_LINUX_KERNEL_XZ=y
BR2_LINUX_KERNEL_NEEDS_HOST_OPENSSL=y
BR2_LINUX_KERNEL_NEEDS_HOST_LIBELF=y
BR2_PACKAGE_BUSYBOX_SHOW_OTHERS=y
BR2_PACKAGE_KEXEC=y
BR2_PACKAGE_KEXEC_ZLIB=y
BR2_PACKAGE_E2FSPROGS=y
BR2_PACKAGE_MMC_UTILS=y
BR2_PACKAGE_LVM2=y
BR2_PACKAGE_LIBOPENSSL_BIN=y
BR2_PACKAGE_OPENSSH=y
BR2_PACKAGE_SOCAT=y
BR2_PACKAGE_UTIL_LINUX_BINARIES=y
BR2_TARGET_ROOTFS_INITRAMFS=y
# BR2_TARGET_ROOTFS_TAR is not set
BR2_PACKAGE_HOST_SQUASHFS=y
```

## configs/ice-elk_modelsx_info2_defconfig
```kconfig
BR2_x86_64=y
BR2_x86_corei7=y
BR2_WGET="wget --passive-ftp -nd -t 3 -4"
BR2_DL_DIR="$(BASE_DIR)/dl"
BR2_TOOLCHAIN_BUILDROOT_VENDOR="tesla"
BR2_TOOLCHAIN_BUILDROOT_MUSL=y
BR2_KERNEL_HEADERS_4_14=y
BR2_TARGET_GENERIC_HOSTNAME="ui"
BR2_TARGET_GENERIC_ISSUE=""
BR2_ENABLE_LOCALE_WHITELIST="en_US"
BR2_LINUX_KERNEL=y
BR2_LINUX_KERNEL_CUSTOM_GIT=y
BR2_LINUX_KERNEL_CUSTOM_REPO_URL="https://github.com/teslamotors/linux.git"
BR2_LINUX_KERNEL_CUSTOM_REPO_VERSION="0c9640bba6a841f524f5947d0741386792674577"
BR2_LINUX_KERNEL_DEFCONFIG="ice-elk"
BR2_PACKAGE_BUSYBOX_SHOW_OTHERS=y
BR2_PACKAGE_KEXEC=y
BR2_PACKAGE_KEXEC_ZLIB=y
BR2_PACKAGE_E2FSPROGS=y
BR2_PACKAGE_MMC_UTILS=y
BR2_PACKAGE_LIBOPENSSL_BIN=y
BR2_PACKAGE_OPENSSH=y
BR2_PACKAGE_SOCAT=y
BR2_PACKAGE_UTIL_LINUX_BINARIES=y
BR2_TARGET_ROOTFS_INITRAMFS=y
# BR2_TARGET_ROOTFS_TAR is not set
BR2_PACKAGE_HOST_SQUASHFS=y
```

## configs/mcu-cid_defconfig
```kconfig
BR2_arm=y
BR2_cortex_a9=y
BR2_ARM_ENABLE_VFP=y
BR2_ARM_EABI=y
BR2_DL_DIR="$(BASE_DIR)/dl"
BR2_GOOGLE_BREAKPAD_ENABLE=y
BR2_TOOLCHAIN_EXTERNAL=y
BR2_TOOLCHAIN_EXTERNAL_CUSTOM=y
BR2_TOOLCHAIN_EXTERNAL_PATH="$(BASE_DIR)/host/toolchain"
BR2_TOOLCHAIN_EXTERNAL_CUSTOM_PREFIX="arm-cortex_a9-linux-gnueabi"
BR2_TOOLCHAIN_EXTERNAL_GCC_5=y
BR2_TOOLCHAIN_EXTERNAL_CUSTOM_GLIBC=y
BR2_TOOLCHAIN_EXTERNAL_CXX=y
BR2_ROOTFS_SKELETON_CUSTOM=y
BR2_INIT_NONE=y
BR2_ROOTFS_DEVICE_TABLE_SUPPORTS_EXTENDED_ATTRIBUTES=y
BR2_TARGET_TZ_INFO=y
BR2_TARGET_LOCALTIME="America/Los_Angeles"
# BR2_PACKAGE_BUSYBOX is not set
BR2_PACKAGE_GSTREAMER=y
BR2_PACKAGE_GSTREAMER1=y
BR2_PACKAGE_GSTREAMER1_MM=y
BR2_PACKAGE_GST1_PLUGINS_BASE_PLUGIN_APP=y
BR2_PACKAGE_GST1_PLUGINS_BASE_PLUGIN_AUDIORATE=y
BR2_PACKAGE_GST1_PLUGINS_BASE_PLUGIN_AUDIOTESTSRC=y
BR2_PACKAGE_GST1_PLUGINS_BASE_PLUGIN_VIDEOCONVERT=y
BR2_PACKAGE_GST1_PLUGINS_BASE_PLUGIN_TCP=y
BR2_PACKAGE_GST1_PLUGINS_BASE_PLUGIN_VIDEORATE=y
BR2_PACKAGE_GST1_PLUGINS_BASE_PLUGIN_ALSA=y
BR2_PACKAGE_GST1_PLUGINS_BASE_PLUGIN_OGG=y
BR2_PACKAGE_GST1_PLUGINS_BASE_PLUGIN_OPUS=y
BR2_PACKAGE_GST1_PLUGINS_BASE_PLUGIN_VORBIS=y
BR2_PACKAGE_GST1_PLUGINS_GOOD=y
BR2_PACKAGE_GST1_PLUGINS_GOOD_PLUGIN_APETAG=y
BR2_PACKAGE_GST1_PLUGINS_GOOD_PLUGIN_AUDIOPARSERS=y
BR2_PACKAGE_GST1_PLUGINS_GOOD_PLUGIN_AUTODETECT=y
# BR2_PACKAGE_GST1_PLUGINS_GOOD_PLUGIN_AVI is not set
BR2_PACKAGE_GST1_PLUGINS_GOOD_PLUGIN_DEBUGUTILS=y
BR2_PACKAGE_GST1_PLUGINS_GOOD_PLUGIN_DEINTERLACE=y
BR2_PACKAGE_GST1_PLUGINS_GOOD_PLUGIN_ICYDEMUX=y
BR2_PACKAGE_GST1_PLUGINS_GOOD_PLUGIN_ID3DEMUX=y
BR2_PACKAGE_GST1_PLUGINS_GOOD_PLUGIN_INTERLEAVE=y
BR2_PACKAGE_GST1_PLUGINS_GOOD_PLUGIN_LEVEL=y
BR2_PACKAGE_GST1_PLUGINS_GOOD_PLUGIN_MATROSKA=y
BR2_PACKAGE_GST1_PLUGINS_GOOD_PLUGIN_MULTIFILE=y
BR2_PACKAGE_GST1_PLUGINS_GOOD_PLUGIN_MULTIPART=y
BR2_PACKAGE_GST1_PLUGINS_GOOD_PLUGIN_RTP=y
BR2_PACKAGE_GST1_PLUGINS_GOOD_PLUGIN_RTPMANAGER=y
BR2_PACKAGE_GST1_PLUGINS_GOOD_PLUGIN_UDP=y
BR2_PACKAGE_GST1_PLUGINS_GOOD_PLUGIN_VIDEOCROP=y
BR2_PACKAGE_GST1_PLUGINS_GOOD_PLUGIN_VIDEOFILTER=y
BR2_PACKAGE_GST1_PLUGINS_GOOD_PLUGIN_WAVENC=y
BR2_PACKAGE_GST1_PLUGINS_GOOD_PLUGIN_FLAC=y
BR2_PACKAGE_GST1_PLUGINS_GOOD_PLUGIN_SOUPHTTPSRC=y
BR2_PACKAGE_GST1_PLUGINS_GOOD_PLUGIN_SPEEX=y
BR2_PACKAGE_GST1_PLUGINS_GOOD_PLUGIN_WAVPACK=y
BR2_PACKAGE_GST1_PLUGINS_BAD=y
BR2_PACKAGE_GST1_PLUGINS_BAD_PLUGIN_AUTOCONVERT=y
BR2_PACKAGE_GST1_PLUGINS_BAD_PLUGIN_STEREO=y
BR2_PACKAGE_GST1_PLUGINS_BAD_PLUGIN_TIMECODE=y
BR2_PACKAGE_GST1_PLUGINS_BAD_PLUGIN_VIDEOPARSERS=y
BR2_PACKAGE_GST1_PLUGINS_BAD_PLUGIN_HLS=y
BR2_PACKAGE_GST1_PLUGINS_BAD_PLUGIN_OPUS=y
BR2_PACKAGE_GST1_PLUGINS_BAD_PLUGIN_VOAACENC=y
BR2_PACKAGE_GST1_PLUGINS_UGLY=y
BR2_PACKAGE_GST1_PLUGINS_UGLY_PLUGIN_ASFDEMUX=y
BR2_PACKAGE_GST1_PLUGINS_UGLY_PLUGIN_AMRNB=y
BR2_PACKAGE_GST1_LIBAV=y
BR2_PACKAGE_LAME=y
BR2_PACKAGE_BLKTRACE=y
BR2_PACKAGE_JQ=y
BR2_PACKAGE_E2FSPROGS=y
# BR2_PACKAGE_E2FSPROGS_OVERWRITE_BUSYBOX is not set
BR2_PACKAGE_E2FSPROGS_E2IMAGE=y
# BR2_PACKAGE_E2FSPROGS_FSCK is not set
BR2_PACKAGE_E2FSPROGS_RESIZE2FS=y
BR2_PACKAGE_MMC_UTILS=y
BR2_PACKAGE_SDL=y
BR2_PACKAGE_SDL2=y
BR2_PACKAGE_SDL2_X11=y
BR2_PACKAGE_SDL2_TTF=y
BR2_PACKAGE_QT=y
BR2_PACKAGE_QT_BUILD_FROM_GIT=y
BR2_PACKAGE_QT_GIT_REPOSITORY="https://github.com/teslamotors/qt.git"
BR2_PACKAGE_QT_GIT_REVISION="9eafaf9ed4fd1fffc4ebe28150c29057b82d5078"
BR2_PACKAGE_QT_X11=y
BR2_PACKAGE_QT_DEBUG=y
BR2_PACKAGE_QT_GIF=y
BR2_PACKAGE_QT_SYSTEMJPEG=y
BR2_PACKAGE_QT_SYSTEMPNG=y
BR2_PACKAGE_QT_SYSTEMTIFF=y
BR2_PACKAGE_QT_SYSTEMZLIB=y
BR2_PACKAGE_QT_SQL_MODULE=y
BR2_PACKAGE_QT_SQLITE_SYSTEM=y
BR2_PACKAGE_QT_DBUS=y
BR2_PACKAGE_QT_SVG=y
BR2_PACKAGE_QT_WEBKIT=y
BR2_PACKAGE_QT_STL=y
BR2_PACKAGE_QT_OPENSSL=y
BR2_PACKAGE_XORG7=y
BR2_PACKAGE_XLIB_LIBXCOMPOSITE=y
BR2_PACKAGE_XLIB_LIBXDAMAGE=y
BR2_PACKAGE_XLIB_LIBXFONT=y
BR2_PACKAGE_XLIB_LIBXFT=y
BR2_PACKAGE_XLIB_LIBXRES=y
BR2_PACKAGE_XLIB_LIBXXF86VM=y
BR2_PACKAGE_XAPP_XAUTH=y
BR2_PACKAGE_XAPP_XDPYINFO=y
BR2_PACKAGE_XAPP_XEYES=y
BR2_PACKAGE_XAPP_XINPUT=y
BR2_PACKAGE_XAPP_XRANDR=y
BR2_PACKAGE_XAPP_XSETROOT=y
BR2_PACKAGE_XFONT_FONT_ALIAS=y
BR2_PACKAGE_XFONT_FONT_CURSOR_MISC=y
BR2_PACKAGE_XFONT_FONT_MISC_MISC=y
BR2_PACKAGE_MCOOKIE=y
BR2_PACKAGE_XKEYBOARD_CONFIG=y
BR2_PACKAGE_PYTHON3=y
BR2_PACKAGE_PYTHON_AENUM=y
BR2_PACKAGE_PYTHON_AIOES=y
BR2_PACKAGE_PYTHON_AIOFILES=y
BR2_PACKAGE_PYTHON_AIOHTTP=y
BR2_PACKAGE_PYTHON_AIOHTTP_CORS=y
BR2_PACKAGE_PYTHON_ALTGRAPH=y
BR2_PACKAGE_PYTHON_APPDIRS=y
BR2_PACKAGE_PYTHON_ASYNC_GENERATOR=y
BR2_PACKAGE_PYTHON_ASYNC_TIMEOUT=y
BR2_PACKAGE_PYTHON_ASYNCIO_EXTRAS=y
BR2_PACKAGE_PYTHON_ASYNCSSH=y
BR2_PACKAGE_PYTHON_ATTRDICT=y
BR2_PACKAGE_PYTHON_BITARRAY=y
BR2_PACKAGE_PYTHON_BLINKER=y
BR2_PACKAGE_PYTHON_CACHETOOLS=y
BR2_PACKAGE_PYTHON_CLICK=y
BR2_PACKAGE_PYTHON_DATEUTIL=y
BR2_PACKAGE_PYTHON_DOTTED=y
BR2_PACKAGE_PYTHON_FLATBUFFERS=y
BR2_PACKAGE_PYTHON_FUTURE=y
BR2_PACKAGE_PYTHON_GITDB2=y
BR2_PACKAGE_PYTHON_GITPYTHON=y
BR2_PACKAGE_PYTHON_INFLECTION=y
BR2_PACKAGE_PYTHON_JSONSCHEMA=y
BR2_PACKAGE_PYTHON_MOCK=y
BR2_PACKAGE_PYTHON_MULTIDICT=y
BR2_PACKAGE_PYTHON_NETIFACES=y
BR2_PACKAGE_PYTHON_PARAMIKO=y
BR2_PACKAGE_PYTHON_PBR=y
BR2_PACKAGE_PYTHON_PIKA=y
BR2_PACKAGE_PYTHON_PLUGGY=y
BR2_PACKAGE_PYTHON_PSUTIL=y
BR2_PACKAGE_PYTHON_PY=y
BR2_PACKAGE_PYTHON_PYASN=y
BR2_PACKAGE_PYTHON_PYASN_MODULES=y
BR2_PACKAGE_PYTHON_PYJWT=y
BR2_PACKAGE_PYTHON_PYPARSING=y
BR2_PACKAGE_PYTHON_PYPNG=y
BR2_PACKAGE_PYTHON_PYYAML=y
BR2_PACKAGE_PYTHON_REQUESTS=y
BR2_PACKAGE_PYTHON_SMMAP2=y
BR2_PACKAGE_PYTHON_SPIDEV=y
BR2_PACKAGE_PYTHON_TELNETLIB3=y
BR2_PACKAGE_PYTHON_TORNADO=y
BR2_PACKAGE_PYTHON_TWISTED=y
BR2_PACKAGE_PYTHON_WEBSOCKET_CLIENT=y
BR2_PACKAGE_PYTHON_WEBSOCKETS=y
BR2_PACKAGE_PYTHON_YARL=y
BR2_PACKAGE_LIBSNDFILE=y
BR2_PACKAGE_TAGLIB=y
BR2_PACKAGE_TAGLIB_MP4=y
BR2_PACKAGE_TAGLIB_ASF=y
BR2_PACKAGE_CA_CERTIFICATES=y
BR2_PACKAGE_LIBSECRET=y
BR2_PACKAGE_LIBSHA1=y
BR2_PACKAGE_LIBOPENSSL_BIN=y
BR2_PACKAGE_TPM2_TSS=y
BR2_PACKAGE_CAIRO=y
BR2_PACKAGE_CAIRO_PNG=y
BR2_PACKAGE_HARFBUZZ=y
BR2_PACKAGE_IMLIB2=y
BR2_PACKAGE_IMLIB2_PNG=y
BR2_PACKAGE_LIBDRM=y
BR2_PACKAGE_WEBP=y
BR2_PACKAGE_LIBPCIACCESS=y
BR2_PACKAGE_LIBUSB=y
BR2_PACKAGE_LIBUSB_COMPAT=y
BR2_PACKAGE_LIBXSLT=y
BR2_PACKAGE_GRPC=y
BR2_PACKAGE_LIBCURL=y
BR2_PACKAGE_CURL=y
BR2_PACKAGE_LIBCURL_VERBOSE=y
BR2_PACKAGE_LIBSOUP_SSL=y
BR2_PACKAGE_BOOST=y
BR2_PACKAGE_BOOST_IOSTREAMS=y
BR2_PACKAGE_BOOST_LOG=y
BR2_PACKAGE_BOOST_PROGRAM_OPTIONS=y
BR2_PACKAGE_FFTW=y
BR2_PACKAGE_FFTW_SINGLE=y
BR2_PACKAGE_LIBCAP=y
BR2_PACKAGE_ICU=y
BR2_PACKAGE_IPTABLES=y
BR2_PACKAGE_OPENSSH=y
BR2_PACKAGE_ULOGD=y
BR2_PACKAGE_PROCPS_NG=y
BR2_PACKAGE_CAPICXX_CORE_RUNTIME=y
BR2_PACKAGE_PROTOBUF3=y
BR2_PACKAGE_RUNIT=y
# BR2_PACKAGE_RUNIT_INIT is not set
BR2_TARGET_ROOTFS_SQUASHFS=y
# BR2_TARGET_ROOTFS_TAR is not set
```

## configs/mcu-infoz_defconfig
```kconfig
BR2_x86_64=y
BR2_x86_corei7=y
BR2_WGET="wget --passive-ftp --no-verbose -nd -t 3 -4"
BR2_DL_DIR="$(BASE_DIR)/dl"
# BR2_COMPILER_PARANOID_UNSAFE_PATH is not set
BR2_TOOLCHAIN_BUILDROOT_VENDOR="tesla"
BR2_TOOLCHAIN_BUILDROOT_GLIBC=y
BR2_KERNEL_HEADERS_5_4=y
BR2_TOOLCHAIN_BUILDROOT_CXX=y
BR2_TARGET_GENERIC_HOSTNAME="infoz"
BR2_TARGET_GENERIC_ISSUE=""
BR2_INIT_NONE=y
BR2_ROOTFS_DEVICE_TABLE_SUPPORTS_EXTENDED_ATTRIBUTES=y
BR2_ENABLE_LOCALE_WHITELIST="en_US"
BR2_TARGET_TZ_INFO=y
BR2_TARGET_LOCALTIME="America/Los_Angeles"
BR2_LINUX_KERNEL=y
BR2_LINUX_KERNEL_CUSTOM_GIT=y
BR2_LINUX_KERNEL_CUSTOM_REPO_URL="https://github.com/teslamotors/linux.git"
BR2_LINUX_KERNEL_CUSTOM_REPO_VERSION="d9644d662e14a3d4961217ff8b9447c5f2e787f7"
BR2_LINUX_KERNEL_DEFCONFIG="infoz"
BR2_LINUX_KERNEL_NEEDS_HOST_LIBELF=y
BR2_LINUX_KERNEL_EXT_INITRAMFS=y
BR2_LINUX_KERNEL_EXT_INITRAMFS_LOCATION="initramfs.cpio.xz"
BR2_LINUX_KERNEL_EXT_INITRAMFS_PKG="linux-initramfs"
BR2_PACKAGE_LINUX_TOOLS_CPUPOWER=y
BR2_PACKAGE_LINUX_TOOLS_PERF=y
BR2_PACKAGE_BUSYBOX_SHOW_OTHERS=y
BR2_PACKAGE_BUSYBOX_INDIVIDUAL_BINARIES=y
BR2_PACKAGE_ALSA_UTILS=y
BR2_PACKAGE_ALSA_UTILS_ALSALOOP=y
BR2_PACKAGE_ALSA_UTILS_APLAY=y
BR2_PACKAGE_ALSA_UTILS_BAT=y
BR2_PACKAGE_FFMPEG=y
BR2_PACKAGE_FFMPEG_SWSCALE=y
BR2_PACKAGE_MPG123=y
BR2_PACKAGE_OPUS_TOOLS=y
BR2_PACKAGE_SOX=y
BR2_PACKAGE_WAVPACK=y
BR2_PACKAGE_BZIP2=y
BR2_PACKAGE_STRACE=y
BR2_PACKAGE_STRESS_NG=y
BR2_PACKAGE_VMTOUCH=y
BR2_PACKAGE_JQ=y
BR2_PACKAGE_LIBTOOL=y
BR2_PACKAGE_E2FSPROGS=y
# BR2_PACKAGE_E2FSPROGS_OVERWRITE_BUSYBOX is not set
# BR2_PACKAGE_E2FSPROGS_FSCK is not set
BR2_PACKAGE_E2FSPROGS_RESIZE2FS=y
BR2_PACKAGE_EXFAT_LINUX=y
BR2_PACKAGE_MMC_UTILS=y
BR2_PACKAGE_MTD=y
# BR2_PACKAGE_MTD_NANDDUMP is not set
# BR2_PACKAGE_MTD_NANDTEST is not set
# BR2_PACKAGE_MTD_NANDWRITE is not set
# BR2_PACKAGE_MTD_UBIATTACH is not set
# BR2_PACKAGE_MTD_UBICRC32 is not set
# BR2_PACKAGE_MTD_UBIDETACH is not set
# BR2_PACKAGE_MTD_UBIFORMAT is not set
# BR2_PACKAGE_MTD_UBIMKVOL is not set
# BR2_PACKAGE_MTD_UBINFO is not set
# BR2_PACKAGE_MTD_UBINIZE is not set
# BR2_PACKAGE_MTD_UBIRENAME is not set
# BR2_PACKAGE_MTD_UBIRMVOL is not set
# BR2_PACKAGE_MTD_UBIRSVOL is not set
# BR2_PACKAGE_MTD_UBIUPDATEVOL is not set
# BR2_PACKAGE_MTD_UBIBLOCK is not set
BR2_PACKAGE_SQUASHFS=y
BR2_PACKAGE_SQUASHFS_LZ4=y
BR2_PACKAGE_SQUASHFS_LZMA=y
BR2_PACKAGE_SQUASHFS_LZO=y
BR2_PACKAGE_SQUASHFS_XZ=y
BR2_PACKAGE_XKEYBOARD_CONFIG=y
BR2_PACKAGE_ACPICA=y
BR2_PACKAGE_CRYPTSETUP=y
BR2_PACKAGE_DBUS=y
BR2_PACKAGE_DMIDECODE=y
BR2_PACKAGE_EVTEST=y
BR2_PACKAGE_I2C_TOOLS=y
BR2_PACKAGE_IOSTAT=y
BR2_PACKAGE_NVME=y
BR2_PACKAGE_READ_EDID=y
BR2_PACKAGE_RTC_TOOLS=y
BR2_PACKAGE_PERL=y
BR2_PACKAGE_ALSA_PLUGINS=y
BR2_PACKAGE_LIBSNDFILE=y
BR2_PACKAGE_SPEEX=y
BR2_PACKAGE_VO_AACENC=y
BR2_PACKAGE_CA_CERTIFICATES=y
BR2_PACKAGE_LIBOPENSSL_BIN=y
BR2_PACKAGE_TPM2_TSS_DELETE_TCTI_DEFAULT=y
BR2_PACKAGE_TPM2_TSS_ENGINE=y
BR2_PACKAGE_SQLITE=y
BR2_PACKAGE_FONTCONFIG=y
BR2_PACKAGE_IMLIB2=y
BR2_PACKAGE_IMLIB2_JPEG=y
BR2_PACKAGE_IMLIB2_PNG=y
BR2_PACKAGE_LIBDRM_INTEL=y
BR2_PACKAGE_LIBDRM_RADEON=y
BR2_PACKAGE_LIBDRM_AMDGPU=y
BR2_PACKAGE_LIBVA=y
BR2_PACKAGE_OPENJPEG=y
BR2_PACKAGE_PIXMAN=y
BR2_PACKAGE_LIBGPIOD=y
BR2_PACKAGE_LIBGPIOD_TOOLS=y
BR2_PACKAGE_LIBUSB=y
BR2_PACKAGE_LIBUSB_EXAMPLES=y
BR2_PACKAGE_LIBUSB_COMPAT=y
BR2_PACKAGE_LIBXKBCOMMON=y
BR2_PACKAGE_MTDEV=y
BR2_PACKAGE_LIBXML2=y
BR2_PACKAGE_LIBTHEORA=y
BR2_PACKAGE_LIBVPX=y
BR2_PACKAGE_LIBCURL_CURL=y
BR2_PACKAGE_LIBPSL=y
BR2_PACKAGE_LIBSRTP=y
BR2_PACKAGE_FFTW=y
BR2_PACKAGE_LIBCAP_NG=y
BR2_PACKAGE_LIBEVDEV=y
BR2_PACKAGE_LIBFFI=y
BR2_PACKAGE_LIBAPPARMOR=y
BR2_PACKAGE_PCRE=y
BR2_PACKAGE_PCRE_UCP=y
BR2_PACKAGE_LINUX_SYSCALL_SUPPORT=y
BR2_PACKAGE_XUTIL_UTIL_MACROS=y
BR2_PACKAGE_BIND=y
BR2_PACKAGE_BIND_TOOLS=y
BR2_PACKAGE_CONNTRACK_TOOLS=y
BR2_PACKAGE_DNSMASQ=y
# BR2_PACKAGE_DNSMASQ_TFTP is not set
# BR2_PACKAGE_DNSMASQ_DHCP is not set
BR2_PACKAGE_IPROUTE2=y
BR2_PACKAGE_IPTABLES=y
BR2_PACKAGE_IW=y
BR2_PACKAGE_NET_TOOLS=y
BR2_PACKAGE_NTP=y
BR2_PACKAGE_OPENSSH=y
BR2_PACKAGE_SOCAT=y
BR2_PACKAGE_TCPDUMP=y
BR2_PACKAGE_ULOGD=y
BR2_PACKAGE_WIRELESS_REGDB=y
BR2_PACKAGE_WIRELESS_TOOLS=y
BR2_PACKAGE_HOST_APPARMOR=y
BR2_PACKAGE_FILE=y
BR2_PACKAGE_INOTIFY_TOOLS=y
BR2_PACKAGE_SUDO=y
BR2_PACKAGE_WHICH=y
BR2_PACKAGE_KMOD=y
BR2_PACKAGE_PROCPS_NG=y
BR2_PACKAGE_TPM2_TOOLS=y
BR2_PACKAGE_TPM2_TOOLS_BINS="createprimary getcap import"
BR2_PACKAGE_UTIL_LINUX_BINARIES=y
BR2_PACKAGE_UTIL_LINUX_HWCLOCK=y
BR2_PACKAGE_UTIL_LINUX_LOGGER=y
BR2_PACKAGE_UTIL_LINUX_LOSETUP=y
BR2_PACKAGE_UTIL_LINUX_LSLOGINS=y
BR2_PACKAGE_UTIL_LINUX_MOUNT=y
BR2_PACKAGE_UTIL_LINUX_NSENTER=y
BR2_PACKAGE_UTIL_LINUX_SCHEDUTILS=y
BR2_PACKAGE_UTIL_LINUX_UNSHARE=y
BR2_PACKAGE_UTIL_LINUX_WIPEFS=y
BR2_PACKAGE_LINUX_INITRAMFS=y
BR2_PACKAGE_LINUX_INITRAMFS_TARGET="mcu-infozi_defconfig"
BR2_PACKAGE_MINIJAIL=y
BR2_PACKAGE_RUNIT=y
BR2_PACKAGE_TESLA_BASH=y
BR2_PACKAGE_TESLA_RSYNC=y
BR2_PACKAGE_TESLA_WHICH=y
BR2_TARGET_ROOTFS_CPIO=y
BR2_TARGET_ROOTFS_SQUASHFS=y
BR2_TARGET_ROOTFS_SQUASHFS4_XZ=y
# BR2_TARGET_ROOTFS_TAR is not set
BR2_PACKAGE_HOST_CHECKSEC=y
BR2_PACKAGE_HOST_CRYPTSETUP=y
BR2_PACKAGE_HOST_JQ=y
BR2_PACKAGE_HOST_KAFEL=y
BR2_PACKAGE_HOST_PYTHON=y
BR2_PACKAGE_HOST_SQUASHFS=y
```

## configs/mcu-infozr_defconfig
```kconfig
BR2_x86_64=y
BR2_x86_corei7=y
BR2_WGET="wget --passive-ftp --no-verbose -nd -t 3 -4"
BR2_DL_DIR="$(BASE_DIR)/dl"
BR2_TOOLCHAIN_BUILDROOT_VENDOR="tesla"
BR2_TOOLCHAIN_BUILDROOT_GLIBC=y
BR2_KERNEL_HEADERS_5_4=y
BR2_TOOLCHAIN_BUILDROOT_CXX=y
BR2_TARGET_GENERIC_HOSTNAME="infoz"
BR2_TARGET_GENERIC_ISSUE="Welcome to infoz recovery"
BR2_INIT_NONE=y
BR2_ENABLE_LOCALE_WHITELIST="en_US"
BR2_LINUX_KERNEL=y
BR2_LINUX_KERNEL_CUSTOM_GIT=y
BR2_LINUX_KERNEL_CUSTOM_REPO_URL="https://github.com/teslamotors/linux.git"
BR2_LINUX_KERNEL_CUSTOM_REPO_VERSION="d9644d662e14a3d4961217ff8b9447c5f2e787f7"
BR2_LINUX_KERNEL_DEFCONFIG="infozr"
BR2_LINUX_KERNEL_XZ=y
BR2_LINUX_KERNEL_NEEDS_HOST_OPENSSL=y
BR2_LINUX_KERNEL_NEEDS_HOST_LIBELF=y
BR2_PACKAGE_BUSYBOX_SHOW_OTHERS=y
BR2_PACKAGE_MTD=y
# BR2_PACKAGE_MTD_NANDDUMP is not set
# BR2_PACKAGE_MTD_NANDTEST is not set
# BR2_PACKAGE_MTD_NANDWRITE is not set
# BR2_PACKAGE_MTD_UBIATTACH is not set
# BR2_PACKAGE_MTD_UBICRC32 is not set
# BR2_PACKAGE_MTD_UBIDETACH is not set
# BR2_PACKAGE_MTD_UBIFORMAT is not set
# BR2_PACKAGE_MTD_UBIMKVOL is not set
# BR2_PACKAGE_MTD_UBINFO is not set
# BR2_PACKAGE_MTD_UBINIZE is not set
# BR2_PACKAGE_MTD_UBIRENAME is not set
# BR2_PACKAGE_MTD_UBIRMVOL is not set
# BR2_PACKAGE_MTD_UBIRSVOL is not set
# BR2_PACKAGE_MTD_UBIUPDATEVOL is not set
# BR2_PACKAGE_MTD_UBIBLOCK is not set
BR2_PACKAGE_LVM2=y
BR2_PACKAGE_NVME=y
BR2_PACKAGE_PCIUTILS=y
BR2_PACKAGE_OPENSSH=y
BR2_PACKAGE_SOCAT=y
BR2_PACKAGE_UTIL_LINUX=y
BR2_PACKAGE_UTIL_LINUX_BINARIES=y
BR2_TARGET_ROOTFS_INITRAMFS=y
# BR2_TARGET_ROOTFS_TAR is not set
BR2_PACKAGE_HOST_SQUASHFS=y
```

## package/ap-linux-syscall-support/Config.in
```kconfig
config BR2_PACKAGE_AP_LINUX_SYSCALL_SUPPORT
	bool "linux-syscall-support (lss)"
	help
	  This project provides a header file that can be included into
	  your application whenever you need to make direct system
	  calls.
	  
	  Tesla: This has been backported to work in our old buildroot
	  for the purpose of autopilot breakpad support.

	  https://chromium.googlesource.com/linux-syscall-support/
```

## package/capicxx-core-runtime-avb/Config.in
```kconfig
config BR2_PACKAGE_CAPICXX_CORE_RUNTIME_AVB
       bool "Common API Core Runtime for AVB libraries"
       help
         CommonAPI C++ is a C++ framework for interprocess and network communication.

         The Intel AVB stack requires a specific version that is older
         than the version required by the Harman tuner, we need two
         versions.

         https://genivi.github.io/capicxx-core-tools/
```

## package/capicxx-core-runtime/Config.in
```kconfig
config BR2_PACKAGE_CAPICXX_CORE_RUNTIME
       bool "Common API Core Runtime"
       help
         CommonAPI C++ is a C++ framework for interprocess and network communication.

         It is used as part of the tuner control stack.

         https://genivi.github.io/capicxx-core-tools/
```

## package/capicxx-dbus-runtime/Config.in
```kconfig
config BR2_PACKAGE_CAPICXX_DBUS_RUNTIME
       bool "Common API DBus Runtime"
       select BR2_PACKAGE_DBUS
       select BR2_PACKAGE_CAPICXX_CORE_RUNTIME_AVB
       help
         CommonAPI C++ is a C++ framework for interprocess and network communication.

         The DBus binding is used by the AVB transport.

         https://github.com/GENIVI/capicxx-dbus-runtime
```

## package/capicxx-someip-runtime/Config.in
```kconfig
config BR2_PACKAGE_CAPICXX_SOMEIP_RUNTIME
       bool "Common API SOME/IP Runtime"
       select BR2_PACKAGE_VSOMEIP
       help
         CommonAPI C++ is a C++ framework for interprocess and network communication.

         It is used as part of the tuner control stack.

         https://genivi.github.io/capicxx-core-tools/
```

## package/ceres-solver/Config.in
```kconfig
config BR2_PACKAGE_CERES_SOLVER
       bool "Ceres-Solver"
       select BR2_PACKAGE_OPENBLAS
       help
         Ceres Solver is an open source C++ library for modeling and solving
         large, complicated optimization problems.

         http://ceres-solver.org
```

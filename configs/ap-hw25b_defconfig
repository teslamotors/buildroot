## configs/ice-mrb_defconfig
```kconfig
BR2_x86_64=y
BR2_x86_corei7=y
BR2_WGET="wget --passive-ftp -nd -t 3 -4"
BR2_DL_DIR="$(BASE_DIR)/dl"
BR2_GOOGLE_BREAKPAD_ENABLE=y
BR2_SSP_STRONG=y
BR2_RELRO_FULL=y
BR2_FORTIFY_SOURCE_2=y
BR2_TOOLCHAIN_BUILDROOT_VENDOR="tesla"
BR2_TOOLCHAIN_BUILDROOT_GLIBC=y
BR2_KERNEL_HEADERS_4_14=y
BR2_TOOLCHAIN_BUILDROOT_CXX=y
BR2_PACKAGE_HOST_GDB=y
BR2_TOOLCHAIN_GLIBC_GCONV_LIBS_COPY=y
BR2_TARGET_GENERIC_HOSTNAME="cid"
BR2_TARGET_GENERIC_ISSUE=""
BR2_INIT_NONE=y
BR2_ROOTFS_DEVICE_CREATION_DYNAMIC_EUDEV=y
BR2_ROOTFS_DEVICE_TABLE_SUPPORTS_EXTENDED_ATTRIBUTES=y
# BR2_TARGET_GENERIC_REMOUNT_ROOTFS_RW is not set
BR2_TARGET_TZ_INFO=y
BR2_TARGET_LOCALTIME="America/Los_Angeles"
BR2_LINUX_KERNEL=y
BR2_LINUX_KERNEL_CUSTOM_GIT=y
BR2_LINUX_KERNEL_CUSTOM_REPO_URL="https://github.com/teslamotors/linux.git"
BR2_LINUX_KERNEL_CUSTOM_REPO_VERSION="0c9640bba6a841f524f5947d0741386792674577"
BR2_LINUX_KERNEL_DEFCONFIG="ice-mrb"
BR2_LINUX_KERNEL_EXT_INITRAMFS=y
BR2_LINUX_KERNEL_EXT_INITRAMFS_LOCATION="initramfs.cpio.xz"
BR2_LINUX_KERNEL_EXT_INITRAMFS_PKG="linux-initramfs"
BR2_PACKAGE_LINUX_TOOLS_PERF=y
BR2_PACKAGE_BUSYBOX_SHOW_OTHERS=y
BR2_PACKAGE_BUSYBOX_INDIVIDUAL_BINARIES=y
BR2_PACKAGE_ALSA_UTILS=y
BR2_PACKAGE_ALSA_UTILS_ALSACONF=y
BR2_PACKAGE_ALSA_UTILS_ACONNECT=y
BR2_PACKAGE_ALSA_UTILS_ALSALOOP=y
BR2_PACKAGE_ALSA_UTILS_ALSAUCM=y
BR2_PACKAGE_ALSA_UTILS_ALSATPLG=y
BR2_PACKAGE_ALSA_UTILS_AMIXER=y
BR2_PACKAGE_ALSA_UTILS_APLAY=y
BR2_PACKAGE_ALSA_UTILS_SPEAKER_TEST=y
# BR2_PACKAGE_FFMPEG_FFMPEG is not set
BR2_PACKAGE_FFMPEG_AVRESAMPLE=y
BR2_PACKAGE_FFMPEG_ENCODERS=""
BR2_PACKAGE_FFMPEG_DECODERS="mp3 mp3float aac h264"
BR2_PACKAGE_FFMPEG_MUXERS=""
BR2_PACKAGE_FFMPEG_DEMUXERS=""
BR2_PACKAGE_FFMPEG_PROTOCOLS=""
# BR2_PACKAGE_FFMPEG_INDEVS is not set
# BR2_PACKAGE_FFMPEG_OUTDEVS is not set
BR2_PACKAGE_GSTREAMER=y
BR2_PACKAGE_GST_PLUGINS_BASE_PLUGIN_VIDEOTESTSRC=y
BR2_PACKAGE_GST_PLUGINS_BASE_PLUGIN_VIDEORATE=y
BR2_PACKAGE_GST_PLUGINS_BASE_PLUGIN_ALSA=y
BR2_PACKAGE_GST_PLUGINS_BASE_PLUGIN_OGG=y
BR2_PACKAGE_GST_PLUGINS_GOOD=y
BR2_PACKAGE_GST_PLUGINS_GOOD_PLUGIN_AUDIOPARSERS=y
BR2_PACKAGE_GST_PLUGINS_GOOD_PLUGIN_AUTODETECT=y
BR2_PACKAGE_GST_PLUGINS_GOOD_PLUGIN_ID3DEMUX=y
BR2_PACKAGE_GST_PLUGINS_GOOD_PLUGIN_ICYDEMUX=y
BR2_PACKAGE_GST_PLUGINS_GOOD_PLUGIN_UDP=y
BR2_PACKAGE_GST_PLUGINS_GOOD_PLUGIN_V4L2=y
BR2_PACKAGE_GST_PLUGINS_GOOD_PLUGIN_FLAC=y
BR2_PACKAGE_GST_PLUGINS_GOOD_PLUGIN_SOUPHTTPSRC=y
BR2_PACKAGE_GST_PLUGINS_GOOD_PLUGIN_SPEEX=y
BR2_PACKAGE_GST_PLUGINS_BAD=y
BR2_PACKAGE_GST_PLUGINS_BAD_PLUGIN_AIFF=y
BR2_PACKAGE_GST_PLUGINS_BAD_PLUGIN_AUTOCONVERT=y
BR2_PACKAGE_GST_PLUGINS_BAD_PLUGIN_H264PARSE=y
BR2_PACKAGE_GST_PLUGINS_BAD_PLUGIN_ID3TAG=y
BR2_PACKAGE_GST_PLUGINS_BAD_PLUGIN_MPEGDEMUX=y
BR2_PACKAGE_GST_PLUGINS_BAD_PLUGIN_MPEGTSDEMUX=y
BR2_PACKAGE_GST_PLUGINS_BAD_PLUGIN_VIDEOPARSERS=y
BR2_PACKAGE_GST_PLUGINS_UGLY=y
BR2_PACKAGE_GST_PLUGINS_UGLY_PLUGIN_ASFDEMUX=y
BR2_PACKAGE_GST_PLUGINS_UGLY_PLUGIN_MPEGAUDIOPARSE=y
BR2_PACKAGE_GST_PLUGINS_UGLY_PLUGIN_MAD=y
BR2_PACKAGE_GST_FFMPEG=y
BR2_PACKAGE_GSTREAMER1=y
BR2_PACKAGE_GSTREAMER1_MM=y
BR2_PACKAGE_GST1_PLUGINS_BASE_PLUGIN_AUDIORATE=y
BR2_PACKAGE_GST1_PLUGINS_BASE_PLUGIN_AUDIOTESTSRC=y
BR2_PACKAGE_GST1_PLUGINS_BASE_PLUGIN_VIDEOCONVERT=y
BR2_PACKAGE_GST1_PLUGINS_BASE_PLUGIN_RAWPARSE=y
BR2_PACKAGE_GST1_PLUGINS_BASE_PLUGIN_TCP=y
BR2_PACKAGE_GST1_PLUGINS_BASE_PLUGIN_VIDEOTESTSRC=y
BR2_PACKAGE_GST1_PLUGINS_BASE_PLUGIN_VIDEORATE=y
BR2_PACKAGE_GST1_PLUGINS_BASE_LIB_OPENGL=y
BR2_PACKAGE_GST1_PLUGINS_BASE_PLUGIN_ALSA=y
BR2_PACKAGE_GST1_PLUGINS_BASE_PLUGIN_OGG=y
BR2_PACKAGE_GST1_PLUGINS_BASE_PLUGIN_OPUS=y
BR2_PACKAGE_GST1_PLUGINS_BASE_PLUGIN_VORBIS=y
BR2_PACKAGE_GST1_PLUGINS_GOOD=y
BR2_PACKAGE_GST1_PLUGINS_GOOD_PLUGIN_APETAG=y
BR2_PACKAGE_GST1_PLUGINS_GOOD_PLUGIN_AUDIOPARSERS=y
BR2_PACKAGE_GST1_PLUGINS_GOOD_PLUGIN_AUTODETECT=y
# BR2_PACKAGE_GST1_PLUGINS_GOOD_PLUGIN_AVI is not set
BR2_PACKAGE_GST1_PLUGINS_GOOD_PLUGIN_DEBUGUTILS=y
BR2_PACKAGE_GST1_PLUGINS_GOOD_PLUGIN_DEINTERLACE=y
BR2_PACKAGE_GST1_PLUGINS_GOOD_PLUGIN_ICYDEMUX=y
BR2_PACKAGE_GST1_PLUGINS_GOOD_PLUGIN_ID3DEMUX=y
BR2_PACKAGE_GST1_PLUGINS_GOOD_PLUGIN_INTERLEAVE=y
BR2_PACKAGE_GST1_PLUGINS_GOOD_PLUGIN_LEVEL=y
BR2_PACKAGE_GST1_PLUGINS_GOOD_PLUGIN_MATROSKA=y
BR2_PACKAGE_GST1_PLUGINS_GOOD_PLUGIN_MONOSCOPE=y
BR2_PACKAGE_GST1_PLUGINS_GOOD_PLUGIN_MULTIFILE=y
BR2_PACKAGE_GST1_PLUGINS_GOOD_PLUGIN_MULTIPART=y
BR2_PACKAGE_GST1_PLUGINS_GOOD_PLUGIN_RTP=y
BR2_PACKAGE_GST1_PLUGINS_GOOD_PLUGIN_RTPMANAGER=y
BR2_PACKAGE_GST1_PLUGINS_GOOD_PLUGIN_UDP=y
BR2_PACKAGE_GST1_PLUGINS_GOOD_PLUGIN_VIDEOCROP=y
BR2_PACKAGE_GST1_PLUGINS_GOOD_PLUGIN_VIDEOFILTER=y
BR2_PACKAGE_GST1_PLUGINS_GOOD_PLUGIN_WAVENC=y
BR2_PACKAGE_GST1_PLUGINS_GOOD_PLUGIN_V4L2=y
BR2_PACKAGE_GST1_PLUGINS_GOOD_PLUGIN_V4L2_PROBE=y
BR2_PACKAGE_GST1_PLUGINS_GOOD_PLUGIN_FLAC=y
BR2_PACKAGE_GST1_PLUGINS_GOOD_PLUGIN_SOUPHTTPSRC=y
BR2_PACKAGE_GST1_PLUGINS_GOOD_PLUGIN_SPEEX=y
BR2_PACKAGE_GST1_PLUGINS_GOOD_PLUGIN_WAVPACK=y
BR2_PACKAGE_GST1_PLUGINS_BAD_PLUGIN_AUTOCONVERT=y
BR2_PACKAGE_GST1_PLUGINS_BAD_PLUGIN_STEREO=y
BR2_PACKAGE_GST1_PLUGINS_BAD_PLUGIN_TIMECODE=y
BR2_PACKAGE_GST1_PLUGINS_BAD_PLUGIN_VIDEOPARSERS=y
BR2_PACKAGE_GST1_PLUGINS_BAD_PLUGIN_HLS=y
BR2_PACKAGE_GST1_PLUGINS_BAD_PLUGIN_OPUS=y
BR2_PACKAGE_GST1_PLUGINS_BAD_PLUGIN_VOAACENC=y
BR2_PACKAGE_GST1_PLUGINS_UGLY=y
BR2_PACKAGE_GST1_PLUGINS_UGLY_PLUGIN_AMRNB=y
BR2_PACKAGE_GST1_LIBAV=y
BR2_PACKAGE_GST1_SHARK=y
BR2_PACKAGE_GST1_VAAPI=y
BR2_PACKAGE_GST1_VAAPI_ENCODERS=y
BR2_PACKAGE_LAME=y
BR2_PACKAGE_SOX=y
BR2_PACKAGE_YAVTA=y
BR2_PACKAGE_STRACE=y
BR2_PACKAGE_STRESS_NG=y
BR2_PACKAGE_JQ=y
BR2_PACKAGE_E2FSPROGS=y
# BR2_PACKAGE_E2FSPROGS_OVERWRITE_BUSYBOX is not set
# BR2_PACKAGE_E2FSPROGS_FSCK is not set
BR2_PACKAGE_MMC_UTILS=y
BR2_PACKAGE_SQUASHFS=y
BR2_PACKAGE_DEJAVU=y
# BR2_PACKAGE_DEJAVU_MONO is not set
# BR2_PACKAGE_DEJAVU_SERIF is not set
# BR2_PACKAGE_DEJAVU_SANS_CONDENSED is not set
# BR2_PACKAGE_DEJAVU_SERIF_CONDENSED is not set
BR2_PACKAGE_LIBERATION=y
BR2_PACKAGE_LIBVA_UTILS=y
BR2_PACKAGE_MESA3D_DEMOS=y
BR2_PACKAGE_MESA3D=y
BR2_PACKAGE_MESA3D_DRI_DRIVER_I965=y
BR2_PACKAGE_MESA3D_OPENGL_EGL=y
BR2_PACKAGE_MESA3D_OPENGL_ES=y
BR2_PACKAGE_SDL=y
# BR2_PACKAGE_SDL_FBCON is not set
BR2_PACKAGE_SDL_MIXER=y
BR2_PACKAGE_SDL_NET=y
BR2_PACKAGE_SDL2=y
BR2_PACKAGE_SDL2_X11=y
BR2_PACKAGE_SDL2_OPENGLES=y
BR2_PACKAGE_SDL2_TTF=y
BR2_PACKAGE_QT=y
BR2_PACKAGE_QT_BUILD_FROM_GIT=y
BR2_PACKAGE_QT_GIT_REPOSITORY="https://github.com/teslamotors/qt.git"
BR2_PACKAGE_QT_GIT_REVISION="b9f26c8a332fb5c82a705a51acf026feaac99c3d"
BR2_PACKAGE_QT_X11=y
BR2_PACKAGE_QT_GIF=y
BR2_PACKAGE_QT_SYSTEMJPEG=y
BR2_PACKAGE_QT_SYSTEMPNG=y
BR2_PACKAGE_QT_SYSTEMTIFF=y
BR2_PACKAGE_QT_SYSTEMZLIB=y
BR2_PACKAGE_QT_SQL_MODULE=y
BR2_PACKAGE_QT_SQLITE_SYSTEM=y
BR2_PACKAGE_QT_OPENGL_ES=y
BR2_PACKAGE_QT_DBUS=y
BR2_PACKAGE_QT_SVG=y
BR2_PACKAGE_QT_WEBKIT=y
BR2_PACKAGE_QT_STL=y
BR2_PACKAGE_QT_OPENSSL=y
BR2_PACKAGE_XORG7=y
BR2_PACKAGE_XSERVER_XORG_SERVER=y
BR2_PACKAGE_XLIB_LIBXSCRNSAVER=y
BR2_PACKAGE_XLIB_LIBXAW=y
BR2_PACKAGE_XLIB_LIBXCOMPOSITE=y
BR2_PACKAGE_XAPP_XCURSORGEN=y
BR2_PACKAGE_XAPP_XDPYINFO=y
BR2_PACKAGE_XAPP_XDRIINFO=y
BR2_PACKAGE_XAPP_XGAMMA=y
BR2_PACKAGE_XAPP_XINIT=y
BR2_PACKAGE_XAPP_XINPUT=y
BR2_PACKAGE_XAPP_XRANDR=y
BR2_PACKAGE_XDRIVER_XF86_INPUT_EVDEV=y
BR2_PACKAGE_XDRIVER_XF86_INPUT_KEYBOARD=y
BR2_PACKAGE_XDRIVER_XF86_INPUT_MOUSE=y
BR2_PACKAGE_XDRIVER_XF86_VIDEO_INTEL=y
BR2_PACKAGE_FEH=y
BR2_PACKAGE_XDOTOOL=y
BR2_PACKAGE_CRYPTSETUP=y
BR2_PACKAGE_EUDEV_RULES_GEN=y
BR2_PACKAGE_EVTEST=y
BR2_PACKAGE_I2C_TOOLS=y
BR2_PACKAGE_IOSTAT=y
BR2_PACKAGE_IQVLINUX=y
BR2_PACKAGE_NANOCOM=y
BR2_PACKAGE_PCIUTILS=y
BR2_PACKAGE_SPI_TOOLS=y
BR2_PACKAGE_PERL=y
BR2_PACKAGE_ALSA_PLUGINS=y
BR2_PACKAGE_FDK_AAC=y
BR2_PACKAGE_LIBSNDFILE=y
BR2_PACKAGE_OPENAL=y
BR2_PACKAGE_MINIZIP=y
BR2_PACKAGE_SNAPPY=y
BR2_PACKAGE_CA_CERTIFICATES=y
BR2_PACKAGE_LIBNSS=y
BR2_PACKAGE_LIBSECRET=y
BR2_PACKAGE_LIBOPENSSL_BIN=y
BR2_PACKAGE_CAIRO=y
BR2_PACKAGE_CAIRO_PNG=y
BR2_PACKAGE_HARFBUZZ=y
BR2_PACKAGE_LIBDRI2=y
BR2_PACKAGE_LIBDRM_INSTALL_TESTS=y
BR2_PACKAGE_LIBVA_INTEL_DRIVER=y
BR2_PACKAGE_WEBP=y
BR2_PACKAGE_WEBP_DEMUX=y
BR2_PACKAGE_WEBP_MUX=y
BR2_PACKAGE_LIBINPUT=y
BR2_PACKAGE_LIBUSB=y
BR2_PACKAGE_LIBUSB_COMPAT=y
BR2_PACKAGE_LIBV4L=y
BR2_PACKAGE_LIBV4L_UTILS=y
BR2_PACKAGE_LIBXSLT=y
BR2_PACKAGE_GRPC=y
BR2_PACKAGE_LIBCURL=y
BR2_PACKAGE_CURL=y
BR2_PACKAGE_LIBKRB5=y
BR2_PACKAGE_LIBSOUP_SSL=y
BR2_PACKAGE_BOOST_IOSTREAMS=y
BR2_PACKAGE_BOOST_PROGRAM_OPTIONS=y
BR2_PACKAGE_FFTW=y
BR2_PACKAGE_FFTW_SINGLE=y
BR2_PACKAGE_LIBCAP_NG=y
BR2_PACKAGE_LIBCGROUP=y
BR2_PACKAGE_LIBCGROUP_TOOLS=y
BR2_PACKAGE_PROTOBUF_C=y
BR2_PACKAGE_ICU=y
BR2_PACKAGE_BIND=y
# BR2_PACKAGE_BIND_SERVER is not set
BR2_PACKAGE_BIND_TOOLS=y
BR2_PACKAGE_CRDA=y
BR2_PACKAGE_DHCPCD=y
BR2_PACKAGE_DNSMASQ=y
# BR2_PACKAGE_DNSMASQ_TFTP is not set
# BR2_PACKAGE_DNSMASQ_DHCP is not set
BR2_PACKAGE_IPROUTE2=y
BR2_PACKAGE_IPTABLES=y
BR2_PACKAGE_IW=y
BR2_PACKAGE_NET_TOOLS=y
BR2_PACKAGE_NTP=y
BR2_PACKAGE_OPENSSH=y
BR2_PACKAGE_SOCAT=y
BR2_PACKAGE_TCPDUMP=y
BR2_PACKAGE_ULOGD=y
BR2_PACKAGE_INOTIFY_TOOLS=y
BR2_PACKAGE_SUDO=y
BR2_PACKAGE_PROCPS_NG=y
BR2_PACKAGE_TPM2_ABRMD=y
BR2_PACKAGE_UTIL_LINUX_BINARIES=y
BR2_PACKAGE_UTIL_LINUX_LOGGER=y
BR2_PACKAGE_UTIL_LINUX_LSLOGINS=y
BR2_PACKAGE_UTIL_LINUX_MOUNT=y
BR2_PACKAGE_UTIL_LINUX_NSENTER=y
BR2_PACKAGE_UTIL_LINUX_SCHEDUTILS=y
BR2_PACKAGE_UTIL_LINUX_UNSHARE=y
BR2_PACKAGE_CAPICXX_CORE_RUNTIME_AVB=y
BR2_PACKAGE_CAPICXX_CORE_RUNTIME=y
BR2_PACKAGE_CAPICXX_DBUS_RUNTIME=y
BR2_PACKAGE_CAPICXX_SOMEIP_RUNTIME=y
BR2_PACKAGE_LINUX_INITRAMFS=y
BR2_PACKAGE_LINUX_INITRAMFS_TARGET="ice-mrbi_defconfig"
BR2_PACKAGE_MINIJAIL=y
BR2_PACKAGE_PROTOBUF3=y
BR2_PACKAGE_RUNIT=y
BR2_PACKAGE_TESLA_AVB_BOOST=y
BR2_PACKAGE_TESLA_AVB_BOOST_FILESYSTEM=y
BR2_PACKAGE_TESLA_AVB_BOOST_SYSTEM=y
BR2_PACKAGE_TESLA_BASH=y
BR2_PACKAGE_TESLA_FINDUTILS=y
BR2_PACKAGE_TESLA_GREP=y
BR2_PACKAGE_TESLA_GZIP=y
BR2_PACKAGE_TESLA_LIBSYSTEMD=y
BR2_PACKAGE_TESLA_RSYNC=y
BR2_PACKAGE_TESLA_WHICH=y
BR2_TARGET_ROOTFS_SQUASHFS=y
BR2_TARGET_ROOTFS_SQUASHFS4_XZ=y
# BR2_TARGET_ROOTFS_TAR is not set
BR2_PACKAGE_HOST_CHECKSEC=y
BR2_PACKAGE_HOST_CRYPTSETUP=y
BR2_PACKAGE_HOST_JQ=y
BR2_PACKAGE_HOST_KAFEL=y
```

## configs/ice-mrbi_defconfig
```kconfig
BR2_x86_64=y
BR2_x86_corei7=y
BR2_WGET="wget --passive-ftp -nd -t 3 -4"
BR2_DL_DIR="$(BASE_DIR)/dl"
BR2_TOOLCHAIN_BUILDROOT_VENDOR="tesla"
BR2_TOOLCHAIN_BUILDROOT_MUSL=y
BR2_KERNEL_HEADERS_CUSTOM_GIT=y
BR2_KERNEL_HEADERS_CUSTOM_REPO_URL="https://github.com/teslamotors/linux.git"
BR2_KERNEL_HEADERS_CUSTOM_REPO_VERSION="0c9640bba6a841f524f5947d0741386792674577"
BR2_PACKAGE_HOST_LINUX_HEADERS_CUSTOM_4_1=y
BR2_BINUTILS_VERSION_2_28_X=y
BR2_ROOTFS_SKELETON_CUSTOM=y
BR2_ROOTFS_SKELETON_CUSTOM_PATH="board/tesla/initramfs_overlay"
BR2_INIT_NONE=y
BR2_ROOTFS_DEVICE_TABLE=""
BR2_ENABLE_LOCALE_WHITELIST="en_US"
BR2_ROOTFS_POST_BUILD_SCRIPT="board/tesla/verity-initramfs-cleanup.sh"
# BR2_PACKAGE_BUSYBOX is not set
BR2_PACKAGE_TESLA_VERITY=y
BR2_PACKAGE_TESLA_VERITY_ICE_MRB=y
BR2_TARGET_ROOTFS_CPIO=y
BR2_TARGET_ROOTFS_CPIO_XZ=y
# BR2_TARGET_ROOTFS_TAR is not set
```

## package/clang/Config.in.host
```kconfig
config BR2_PACKAGE_HOST_CLANG
	bool "host clang"
	depends on BR2_PACKAGE_LLVM_ARCH_SUPPORTS
	depends on BR2_HOST_GCC_AT_LEAST_4_8
	select BR2_PACKAGE_HOST_LLVM
	select BR2_PACKAGE_HOST_LLD
	help
	  Clang is a C/C++, Objective C/C++ and OpenCL C front-end
	  cross-compiler with multiple architecture support built
	  from the LLVM libraries.

	  http://clang.llvm.org

comment "clang needs host gcc >= 4.8"
	depends on BR2_PACKAGE_LLVM_ARCH_SUPPORTS
	depends on !BR2_HOST_GCC_AT_LEAST_4_8
```

## package/exfat-linux/Config.in
```kconfig
config BR2_PACKAGE_EXFAT_LINUX
	bool "exfat-linux (arter97)"
	help
	  Third party kernel module for supporting exFAT
	  https://github.com/arter97/exfat-linux
```

## package/fluidsynth/Config.in
```kconfig
config BR2_PACKAGE_FLUIDSYNTH
	bool "fluidsynth"
	select BR2_PACKAGE_ALSA_LIB_RAWMINI
	select BR2_PACKAGE_ALSA_LIB_SEQ
	select BR2_PACKAGE_ALSA_LIB_HWDEP
	select BR2_PACKAGE_ALSA_LIB
	help
	  Fluidsynth is a real-time soundfont software synthesizer
```

## package/google-benchmark/Config.in
```kconfig
config BR2_PACKAGE_GOOGLE_BENCHMARK
	bool "google-benchmark"
	help
	  Install Google Benchmark for C++ unit-test performance measurements.
```

## package/gvfs/Config.in
```kconfig
config BR2_PACKAGE_GVFS
	bool "gvfs"
	depends on BR2_USE_WCHAR # glib2
	depends on BR2_USE_MMU # dbus, glib2
	depends on BR2_TOOLCHAIN_HAS_THREADS # dbus, glib2
	depends on !BR2_STATIC_LIBS
	select BR2_PACKAGE_GSETTINGS_DESKTOP_SCHEMAS
	select BR2_PACKAGE_LIBGLIB2
	select BR2_PACKAGE_DBUS
	select BR2_PACKAGE_SHARED_MIME_INFO
	help
	  gvfs is a userspace virtual filesystem where mount runs as a
	  separate processes which you talk to via D-Bus. It also
	  contains a gio module that seamlessly adds gvfs support to
	  all applications using the gio API. It also supports exposing
	  the gvfs mounts to non-gio applications using fuse.

	  https://wiki.gnome.org/action/show/Projects/gvfs

if BR2_PACKAGE_GVFS

config BR2_PACKAGE_GVFS_ADMIN
	bool "admin"
	default y if BR2_PACKAGE_LIBCAP && BR2_PACKAGE_POLKIT
	help
	  Backend for admin access for local filesystem

config BR2_PACKAGE_GVFS_AFP
	bool "afp"
	default y if BR2_PACKAGE_LIBGCRYPT
	help
	  Backend for AFP protocol

config BR2_PACKAGE_GVFS_ARCHIVE
	bool "archive"
	default y if BR2_PACKAGE_LIBARCHIVE
	help
	  Backend for archive files

config BR2_PACKAGE_GVFS_CDDA
	bool "cdda"
	default y if BR2_PACKAGE_LIBCDIO_PARANOIA && BR2_PACKAGE_LIBGUDEV
	help
	  Backend for audio disks

config BR2_PACKAGE_GVFS_DNSSD
	bool "dnssd"
	default y if BR2_PACKAGE_AVAHI
	help
	  Backend for DNS-SD devices on the network

config BR2_PACKAGE_GVFS_GPHOTO2
	bool "gphoto2"
	default y if BR2_PACKAGE_LIBGPHOTO2 && BR2_PACKAGE_LIBGUDEV
	help
	  Backend for PTP protocol

config BR2_PACKAGE_GVFS_HTTP
	bool "http"
	default y if BR2_PACKAGE_LIBSOUP && BR2_PACKAGE_LIBXML2
	help
	  Backend for HTTP protocol

config BR2_PACKAGE_GVFS_NFS
	bool "nfs"
	default y if BR2_PACKAGE_LIBNFS
	help
	  Backend for NFS v2 and v3 protocols

config BR2_PACKAGE_GVFS_SMB
	bool "smb"
	default y if BR2_PACKAGE_SAMBA4
	help
	  Backend for SMB/CIFS protocol

endif

comment "gvfs needs a toolchain w/ wchar, threads, dynamic library"
	depends on BR2_USE_MMU
	depends on !BR2_USE_WCHAR || !BR2_TOOLCHAIN_HAS_THREADS || \
		BR2_STATIC_LIBS
```

## package/intel-gpu-tools/Config.in
```kconfig
config BR2_PACKAGE_INTEL_GPU_TOOLS
	bool "intel-gpu-tools"
	select BR2_PACKAGE_LIBDRM
	select BR2_PACKAGE_LIBDRM_INTEL
	select BR2_PACKAGE_CAIRO
	select BR2_PACKAGE_CAIRO_PNG
	select BR2_PACKAGE_LIBGLIB2
	select BR2_PACKAGE_LIBPCIACCESS

	help
	  This is a collection of tools for development and testing of the Intel DRM driver.

	  https://01.org/linuxgraphics/
```

## package/kafel/Config.in
```kconfig
config BR2_PACKAGE_KAFEL
	bool "kafel"
	help
          Kafel - A language and library for specifying syscall filtering policies.

          https://github.com/google/kafel
```

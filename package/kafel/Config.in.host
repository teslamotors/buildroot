## package/kafel/Config.in.host
```kconfig
config BR2_PACKAGE_HOST_KAFEL
	bool "host kafel"
	select BR2_PACKAGE_HOST_PYTHON_CFFI
	help
	  Kafel - A language and library for specifying syscall filtering policies.

	  https://github.com/google/kafel
```

## package/khronos-vulkan/Config.in
```kconfig
source "package/khronos-vulkan/khronos-vulkan-headers/Config.in"
source "package/khronos-vulkan/khronos-vulkan-loader/Config.in"
```

## package/khronos-vulkan/khronos-vulkan-headers/Config.in
```kconfig
config BR2_PACKAGE_KHRONOS_VULKAN_HEADERS
	bool "khronos-vulkan-headers"
	help
	  Khronos Vulkan library headers
```

## package/khronos-vulkan/khronos-vulkan-loader/Config.in
```kconfig
config BR2_PACKAGE_KHRONOS_VULKAN_LOADER
	bool "khronos-vulkan-loader"
	select BR2_PACKAGE_MESA3D
	select BR2_PACKAGE_MESA3D_VULKAN_DRIVER
	select BR2_PACKAGE_XLIB_LIBX11
	select BR2_PACKAGE_XLIB_LIBXEXT
	select BR2_PACKAGE_XLIB_LIBXRANDR
	select BR2_PACKAGE_KHRONOS_VULKAN_HEADERS
	help
	  Khronos Vulkan loader library
```

## package/libbacktrace/Config.in
```kconfig
config BR2_PACKAGE_LIBBACKTRACE
       bool "libbacktrace"
       help
         libbacktrace - unwinding library

         https://github.com/ianlancetaylor/libbacktrace
```

## package/libmicrohttpd/Config.in
```kconfig
config BR2_PACKAGE_LIBMICROHTTPD
	bool "libmicrohttpd"
	depends on BR2_TOOLCHAIN_HAS_THREADS
	help
	  GNU libmicrohttpd is a small C library that makes it easy to
	  run an HTTP server as part of another application.

	  http://www.gnu.org/software/libmicrohttpd/

if BR2_PACKAGE_LIBMICROHTTPD

config BR2_PACKAGE_LIBMICROHTTPD_SSL
	bool "https support"
	depends on !BR2_STATIC_LIBS # gnutls
	depends on BR2_USE_WCHAR
	select BR2_PACKAGE_GNUTLS
	help
	  Enable HTTPS (SSL) support.

config BR2_PACKAGE_LIBMICROHTTPD_EPOLL
	bool "epoll support"
	default y
	help
	  epoll support

config BR2_PACKAGE_LIBMICROHTTPD_HTTP_BASIC_AUTH
	bool "http basic auth support"
	default y
	help
	  HTTP basic authentication support

config BR2_PACKAGE_LIBMICROHTTPD_HTTP_DIGEST_AUTH
	bool "http digest auth support"
	default y
	help
	  HTTP digest authentication support

config BR2_PACKAGE_LIBMICROHTTPD_HTTP_UPGRADE
	bool "http upgrade support"
	default y
	help
	  HTTP Upgrade support

comment "libmicrohttpd https support needs a toolchain w/ wchar, dynamic library"
	depends on !BR2_USE_WCHAR || BR2_STATIC_LIBS

endif

comment "libmicrohttpd needs a toolchain w/ threads"
	depends on !BR2_TOOLCHAIN_HAS_THREADS
```

## package/libnih/Config.in
```kconfig
config BR2_PACKAGE_LIBNIH
	bool "libnih"
	depends on BR2_PACKAGE_DBUS
	help
         Small library for C application development containing functions that,
         despite its name, are not implemented elsewhere in the standard
         library set.

         https://launchpad.net/libnih
```

## package/libnvme/Config.in
```kconfig
config BR2_PACKAGE_LIBNVME
	bool "libnvme"
	select BR2_PACKAGE_UTIL_LINUX
	select BR2_PACKAGE_UTIL_LINUX_LIBUUID
	help
	  https://github.com/linux-nvme/libnvme
```

## package/libpcap/Config.in
```kconfig
config BR2_PACKAGE_LIBPCAP
	bool "libpcap"
	select BR2_PACKAGE_BLUEZ5_UTILS_HEADERS if BR2_PACKAGE_BLUEZ5_UTILS
	help
	  A system-independent library for user-level network packet
	  capture.

	  http://www.tcpdump.org/

if BR2_PACKAGE_LIBPCAP
    config BR2_PACKAGE_LIBPCAP_DISABLE_PACKET_RING
    bool "Disable packet-ring support"
    help
      Disable packet-ring mmpap support in libpcap
endif
```

## package/libpng/Config.in
```kconfig
config BR2_PACKAGE_LIBPNG
	bool "libpng"
	select BR2_PACKAGE_ZLIB
	help
	  Library for handling PNG (Portable Network Graphics)
	  images.

	  http://www.libpng.org/

if BR2_PACKAGE_LIBPNG

config BR2_PACKAGE_LIBPNG_VER12
       bool "libpng-1.2.56"
       help
          Use version 1.2.56 of libpng instead of the default one

endif
```

## package/libpsl/Config.in
```kconfig
config BR2_PACKAGE_LIBPSL
	bool "libpsl"
	help
	  C library for the Public Suffix List

	  https://github.com/rockdaboot/libpsl
```

## package/libswitchroot/Config.in
```kconfig
config BR2_PACKAGE_LIBSWITCHROOT
       bool "Switch root library"
       help
         Library for switch root
```

## package/libuuid/Config.in.host
```kconfig
config BR2_HOST_LIBUUID
       bool "host-libuuid"
       help
         Library to generate UUID
```

## package/linux-initramfs/Config.in
```kconfig
config BR2_PACKAGE_LINUX_INITRAMFS
	bool "Linux Initramfs Image"
	select BR2_LINUX_KERNEL_TOOL_CUSTOM_INITRAMFS
	help
	 This option will build the linux initramfs image from the
	 buildroot target specified in BR2_PACKAGE_LINUX_INITRAMFS_TARGET.

if BR2_PACKAGE_LINUX_INITRAMFS

config BR2_PACKAGE_LINUX_INITRAMFS_TARGET
	string "Linux initramfs buildroot target"
	default "buildroot-target"
	help
	  Select the buildroot target for creating the Linux initramfs.

config BR2_PACKAGE_LINUX_INITRAMFS_CONFIG_FRAGMENT_FILES
	string "Additional linux initramfs buildroot configuration fragment files"
	help
	  A space-separated list of buildroot configuration fragment files,
	  that will be merged to the buildroot target configuration file.

endif
```

## package/llvm/Config.in.host
```kconfig
config BR2_PACKAGE_HOST_LLVM
	bool "llvm"
	depends on BR2_PACKAGE_LLVM_ARCH_SUPPORTS
	depends on BR2_HOST_GCC_AT_LEAST_4_8
	depends on BR2_USE_WCHAR # std::wstring
	help
	  The LLVM Project is a collection of modular and reusable
	  compiler and toolchain technologies.

	  http://llvm.org

if BR2_PACKAGE_HOST_LLVM

config BR2_PACKAGE_HOST_LLVM_HOST_ARCH
	string
	default "X86" if BR2_HOSTARCH = "x86" || BR2_HOSTARCH = "x86_64"
	default "AArch64" if BR2_HOSTARCH="aarch64"
	default "ARM" if BR2_HOSTARCH = "arm"

endif

comment "llvm needs host gcc >= 4.8"
	depends on BR2_PACKAGE_LLVM_ARCH_SUPPORTS
	depends on !BR2_HOST_GCC_AT_LEAST_4_8
```

## package/lmms/Config.in
```kconfig
config BR2_PACKAGE_LMMS
	bool "lmms"
	select BR2_PACKAGE_FFTW
	select BR2_PACKAGE_FFTW_SINGLE
	select BR2_PACKAGE_FLUIDSYNTH
	select BR2_PACKAGE_LAME
	select BR2_PACKAGE_LIBSNDFILE
	select BR2_PACKAGE_QT
	help
	  lmms is an open source synthesizer
```

## package/mawk/Config.in
```kconfig
config BR2_PACKAGE_MAWK
       bool "mawk"
       help
         mawk is an interpreter for the AWK Programming Language.

         https://invisible-island.net/mawk/
```

## package/metis/Config.in
```kconfig
config BR2_PACKAGE_METIS
       bool "metis"
       help
         Serial Graph Partitioning and Fill-reducing Matrix Ordering

         http://glaros.dtc.umn.edu/gkhome/metis/metis/overview
```

## package/minijail/Config.in
```kconfig
config BR2_PACKAGE_MINIJAIL
       bool "Minijail"
       select BR2_PACKAGE_LIBCAP
       select BR2_PACKAGE_KAFEL
       help
         Minijail

         https://android.googlesource.com/platform/external/minijail/+/master
```

## package/mmc-utils/Config.in
```kconfig
config BR2_PACKAGE_MMC_UTILS
	bool "mmc-utils"
	help
	  MMC utils

	  https://git.kernel.org/cgit/linux/kernel/git/cjb/mmc-utils.git
```

## package/musl-libc/Config.in
```kconfig
config BR2_PACKAGE_MUSL_LIBC
       bool "musl-libc"
       help
         The musl-libc toolchain
```

## package/nacl/Config.in
```kconfig
config BR2_PACKAGE_NACL
       bool "nacl"
       help
         NaCl -- Networking and Cryptography library

         https://nacl.cr.yp.to

config BR2_PACKAGE_NACL_BINARY
    bool "nacl binary"
    default n
    help
      Installs the nacl binary
```

## package/perl-algorithm-c3/Config.in
```kconfig
config BR2_PACKAGE_PERL_ALGORITHM_C3
	bool "perl-algorithm-c3"
	help
	  A module for merging hierarchies using the C3 algorithm

	  https://metacpan.org/release/Algorithm-C3
```

## package/perl-b-hooks-endofscope/Config.in
```kconfig
config BR2_PACKAGE_PERL_B_HOOKS_ENDOFSCOPE
	bool "perl-b-hooks-endofscope"
	select BR2_PACKAGE_PERL_MODULE_IMPLEMENTATION
	select BR2_PACKAGE_PERL_SUB_EXPORTER_PROGRESSIVE
	help
	  Execute code after a scope finished compilation

	  https://github.com/karenetheridge/B-Hooks-EndOfScope
```

## package/perl-capture-tiny/Config.in
```kconfig
config BR2_PACKAGE_PERL_CAPTURE_TINY
	bool "perl-capture-tiny"
	help
	  Capture STDOUT and STDERR from Perl, XS or external programs

	  https://github.com/dagolden/Capture-Tiny
```

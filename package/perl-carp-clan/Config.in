## package/perl-carp-clan/Config.in
```kconfig
config BR2_PACKAGE_PERL_CARP_CLAN
	bool "perl-carp-clan"
	help
	  Report errors from perspective of caller of a "clan" of modules

	  https://metacpan.org/release/Carp-Clan
```

## package/perl-class-accessor-chained/Config.in
```kconfig
config BR2_PACKAGE_PERL_CLASS_ACCESSOR_CHAINED
	bool "perl-class-accessor-chained"
	select BR2_PACKAGE_PERL_CLASS_ACCESSOR
	help
	  Faster, but less expandable, chained accessors

	  https://metacpan.org/release/Class-Accessor-Chained
```

## package/perl-class-accessor-grouped/Config.in
```kconfig
config BR2_PACKAGE_PERL_CLASS_ACCESSOR_GROUPED
	bool "perl-class-accessor-grouped"
	select BR2_PACKAGE_PERL_MODULE_RUNTIME
	help
	  Lets you build groups of accessors

	  https://metacpan.org/release/Class-Accessor-Grouped
```

## package/perl-class-accessor/Config.in
```kconfig
config BR2_PACKAGE_PERL_CLASS_ACCESSOR
	bool "perl-class-accessor"
	help
	  Automated accessor generation

	  https://metacpan.org/release/Class-Accessor
```

## package/perl-class-c3-componentised/Config.in
```kconfig
config BR2_PACKAGE_PERL_CLASS_C3_COMPONENTISED
	bool "perl-class-c3-componentised"
	select BR2_PACKAGE_PERL_CLASS_C3
	select BR2_PACKAGE_PERL_CLASS_INSPECTOR
	select BR2_PACKAGE_PERL_MRO_COMPAT
	help
	  https://metacpan.org/release/Class-C3-Componentised
```

## package/perl-class-c3/Config.in
```kconfig
config BR2_PACKAGE_PERL_CLASS_C3
	bool "perl-class-c3"
	select BR2_PACKAGE_PERL_ALGORITHM_C3
	help
	  A pragma to use the C3 method resolution order algorithm

	  https://metacpan.org/release/Class-C3
```

## package/perl-class-xsaccessor/Config.in
```kconfig
config BR2_PACKAGE_PERL_CLASS_XSACCESSOR
	bool "perl-class-xsaccessor"
	depends on !BR2_STATIC_LIBS
	help
	  Generate fast XS accessors without runtime compilation

	  https://metacpan.org/release/Class-XSAccessor

comment "perl-class-xsaccessor needs a toolchain w/ dynamic library"
	depends on BR2_STATIC_LIBS
```

## package/perl-config-any/Config.in
```kconfig
config BR2_PACKAGE_PERL_CONFIG_ANY
	bool "perl-config-any"
	select BR2_PACKAGE_PERL_MODULE_PLUGGABLE
	help
	  Load configuration from different file formats, transparently

	  https://metacpan.org/release/Config-Any
```

## package/perl-config-autoconf/Config.in
```kconfig
config BR2_PACKAGE_PERL_CONFIG_AUTOCONF
	bool "perl-config-autoconf"
	select BR2_PACKAGE_PERL_CAPTURE_TINY
	help
	  A module to implement some of AutoConf macros in pure perl.

	  https://metacpan.org/release/Config-AutoConf
```

## package/perl-context-preserve/Config.in
```kconfig
config BR2_PACKAGE_PERL_CONTEXT_PRESERVE
	bool "perl-context-preserve"
	help
	  run code after a subroutine call, preserving the context the subroutine would have seen if it were the last statement in the caller

	  https://metacpan.org/release/Context-Preserve
```

## package/perl-data-dumper-concise/Config.in
```kconfig
config BR2_PACKAGE_PERL_DATA_DUMPER_CONCISE
	bool "perl-data-dumper-concise"
	help
	  Less indentation and newlines plus sub deparsing

	  http://git.shadowcat.co.uk/gitweb/gitweb.cgi?p=p5sagit/Data-Dumper-Concise.git;a=summary
```

## package/perl-data-page/Config.in
```kconfig
config BR2_PACKAGE_PERL_DATA_PAGE
	bool "perl-data-page"
	select BR2_PACKAGE_PERL_CLASS_ACCESSOR_CHAINED
	help
	  help when paging through sets of results

	  https://metacpan.org/release/Data-Page
```

## package/perl-dbd-sqlite/Config.in
```kconfig
config BR2_PACKAGE_PERL_DBD_SQLITE
	bool "perl-dbd-sqlite"
	depends on !BR2_STATIC_LIBS
	select BR2_PACKAGE_PERL_DBI
	help
	  Self Contained SQLite RDBMS in a DBI Driver

	  https://metacpan.org/release/DBD-SQLite

comment "perl-dbd-sqlite needs a toolchain w/ dynamic library"
	depends on BR2_STATIC_LIBS
```

## package/perl-dbix-class-dynamicsubclass/Config.in
```kconfig
config BR2_PACKAGE_PERL_DBIX_CLASS_DYNAMICSUBCLASS
	bool "perl-dbix-class-dynamicsubclass"
	depends on !BR2_STATIC_LIBS
	select BR2_PACKAGE_PERL_DBIX_CLASS
	help
	  Convenient way to use dynamic subclassing.

	  https://metacpan.org/release/DBIx-Class-DynamicSubclass

comment "perl-dbix-class-dynamicsubclass needs a toolchain w/ dynamic library"
	depends on BR2_STATIC_LIBS
```

## package/perl-dbix-class-optimisticlocking/Config.in
```kconfig
config BR2_PACKAGE_PERL_DBIX_CLASS_OPTIMISTICLOCKING
	bool "perl-dbix-class-optimisticlocking"
	depends on !BR2_STATIC_LIBS
	select BR2_PACKAGE_PERL_DBIX_CLASS
	help
	  Optimistic locking support for DBIx::Class

	  https://metacpan.org/release/DBIx-Class-OptimisticLocking

comment "perl-dbix-class-optimisticlocking needs a toolchain w/ dynamic library"
	depends on BR2_STATIC_LIBS
```

## package/perl-dbix-class/Config.in
```kconfig
config BR2_PACKAGE_PERL_DBIX_CLASS
	bool "perl-dbix-class"
	depends on !BR2_STATIC_LIBS
	select BR2_PACKAGE_PERL_CLASS_ACCESSOR_GROUPED
	select BR2_PACKAGE_PERL_CLASS_C3_COMPONENTISED
	select BR2_PACKAGE_PERL_CLASS_INSPECTOR
	select BR2_PACKAGE_PERL_CONFIG_ANY
	select BR2_PACKAGE_PERL_CONTEXT_PRESERVE
	select BR2_PACKAGE_PERL_DBI
	select BR2_PACKAGE_PERL_DATA_DUMPER_CONCISE
	select BR2_PACKAGE_PERL_DATA_PAGE
	select BR2_PACKAGE_PERL_DEVEL_GLOBALDESTRUCTION
	select BR2_PACKAGE_PERL_HASH_MERGE
	select BR2_PACKAGE_PERL_MRO_COMPAT
	select BR2_PACKAGE_PERL_MODULE_FIND
	select BR2_PACKAGE_PERL_MOO
	select BR2_PACKAGE_PERL_PATH_CLASS
	select BR2_PACKAGE_PERL_SQL_ABSTRACT
	select BR2_PACKAGE_PERL_SCOPE_GUARD
	select BR2_PACKAGE_PERL_SUB_NAME
	select BR2_PACKAGE_PERL_TRY_TINY
	select BR2_PACKAGE_PERL_NAMESPACE_CLEAN
	help
	  Extensible and flexible object <-> relational mapper.

	  http://www.dbix-class.org/

comment "perl-dbix-class needs a toolchain w/ dynamic library"
	depends on BR2_STATIC_LIBS
```

## package/perl-expect/Config.in
```kconfig
config BR2_PACKAGE_PERL_EXPECT
       bool "perl-expect"
       select BR2_PACKAGE_PERL_IO_TTY
        help
          automate interactions with command line programs that expose a text terminal interface.

          https://metacpan.org/release/Expect
```

## package/perl-extutils-config/Config.in
```kconfig
config BR2_PACKAGE_PERL_EXTUTILS_CONFIG
	bool "perl-extutils-config"
	help
	  A wrapper for perl's configuration

	  https://metacpan.org/release/ExtUtils-Config
```

## package/perl-extutils-helpers/Config.in
```kconfig
config BR2_PACKAGE_PERL_EXTUTILS_HELPERS
	bool "perl-extutils-helpers"
	help
	  Various portability utilities for module builders

	  https://metacpan.org/release/ExtUtils-Helpers
```

## package/perl-extutils-installpaths/Config.in
```kconfig
config BR2_PACKAGE_PERL_EXTUTILS_INSTALLPATHS
	bool "perl-extutils-installpaths"
	select BR2_PACKAGE_PERL_EXTUTILS_CONFIG
	help
	  Build.PL install path logic made easy

	  https://metacpan.org/release/ExtUtils-InstallPaths
```

## package/perl-file-sharedir-install/Config.in
```kconfig
config BR2_PACKAGE_PERL_FILE_SHAREDIR_INSTALL
	bool "perl-file-sharedir-install"
	help
	  Install shared files

	  https://github.com/Perl-Toolchain-Gang/File-ShareDir-Install
```

## package/perl-hash-merge/Config.in
```kconfig
config BR2_PACKAGE_PERL_HASH_MERGE
	bool "perl-hash-merge"
	depends on !BR2_STATIC_LIBS
	select BR2_PACKAGE_PERL_CLONE
	help
	  Merges arbitrarily deep hashes into a single hash

	  https://metacpan.org/release/Hash-Merge

comment "perl-hash-merge needs a toolchain w/ dynamic library"
	depends on BR2_STATIC_LIBS
```

## package/perl-http-server-simple/Config.in
```kconfig
config BR2_PACKAGE_PERL_HTTP_SERVER_SIMPLE
	bool "perl-http-server-simple"
	depends on !BR2_STATIC_LIBS
	select BR2_PACKAGE_PERL_CGI
	help
	  Lightweight HTTP server

	  https://metacpan.org/release/HTTP-Server-Simple

comment "perl-http-server-simple needs a toolchain w/ dynamic library"
	depends on BR2_STATIC_LIBS
```

## package/perl-import-into/Config.in
```kconfig
config BR2_PACKAGE_PERL_IMPORT_INTO
	bool "perl-import-into"
	select BR2_PACKAGE_PERL_MODULE_RUNTIME
	help
	  Import packages into other packages

	  https://metacpan.org/release/Import-Into
```

## package/perl-inc-latest/Config.in
```kconfig
config BR2_PACKAGE_PERL_INC_LATEST
	bool "perl-inc-latest"
	help
	  use modules bundled in inc/ if they are newer than installed ones

	  https://github.com/dagolden/inc-latest
```

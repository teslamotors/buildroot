## package/perl-io-tty/Config.in
```kconfig
config BR2_PACKAGE_PERL_IO_TTY
	bool "perl-io-tty"
	depends on !BR2_STATIC_LIBS
	help
	  Pseudo ttys and constants

	  https://metacpan.org/release/IO-Tty

comment "perl-io-tty needs a toolchain w/ dynamic library"
	depends on BR2_STATIC_LIBS
```

## package/perl-json/Config.in
```kconfig
config BR2_PACKAGE_PERL_JSON
	bool "perl-json"
	help
	  JSON (JavaScript Object Notation) encoder/decoder

	  https://metacpan.org/release/JSON
```

## package/perl-list-moreutils/Config.in
```kconfig
config BR2_PACKAGE_PERL_LIST_MOREUTILS
	bool "perl-list-moreutils"
	depends on !BR2_STATIC_LIBS
	select BR2_PACKAGE_PERL_EXPORTER_TINY
	help
	  Provide the stuff missing in List::Util

	  https://metacpan.org/release/List-MoreUtils

comment "perl-list-moreutils needs a toolchain w/ dynamic library"
	depends on BR2_STATIC_LIBS
```

## package/perl-module-build-tiny/Config.in
```kconfig
config BR2_PACKAGE_PERL_MODULE_BUILD_TINY
	bool "perl-module-build-tiny"
	select BR2_PACKAGE_PERL_EXTUTILS_CONFIG
	select BR2_PACKAGE_PERL_EXTUTILS_HELPERS
	select BR2_PACKAGE_PERL_EXTUTILS_INSTALLPATHS
	help
	  A tiny replacement for Module::Build

	  https://metacpan.org/release/Module-Build-Tiny
```

## package/perl-module-find/Config.in
```kconfig
config BR2_PACKAGE_PERL_MODULE_FIND
	bool "perl-module-find"
	help
	  Find and use installed modules in a (sub)category

	  https://metacpan.org/release/Module-Find
```

## package/perl-module-pluggable/Config.in
```kconfig
config BR2_PACKAGE_PERL_MODULE_PLUGGABLE
	bool "perl-module-pluggable"
	help
	  automatically give your module the ability to have plugins

	  https://metacpan.org/release/Module-Pluggable
```

## package/perl-moo/Config.in
```kconfig
config BR2_PACKAGE_PERL_MOO
	bool "perl-moo"
	select BR2_PACKAGE_PERL_CLASS_METHOD_MODIFIERS
	select BR2_PACKAGE_PERL_DEVEL_GLOBALDESTRUCTION
	select BR2_PACKAGE_PERL_MODULE_RUNTIME
	select BR2_PACKAGE_PERL_ROLE_TINY
	help
	  Minimalist Object Orientation (with Moose compatibility)

	  https://metacpan.org/release/Moo
```

## package/perl-mro-compat/Config.in
```kconfig
config BR2_PACKAGE_PERL_MRO_COMPAT
	bool "perl-mro-compat"
	help
	  mro::* interface compatibility for Perls < 5.9.5

	  https://metacpan.org/release/MRO-Compat
```

## package/perl-namespace-clean/Config.in
```kconfig
config BR2_PACKAGE_PERL_NAMESPACE_CLEAN
	bool "perl-namespace-clean"
	select BR2_PACKAGE_PERL_B_HOOKS_ENDOFSCOPE
	select BR2_PACKAGE_PERL_PACKAGE_STASH
	help
	  Keep imports and functions out of your namespace

	  http://search.cpan.org/dist/namespace-clean
```

## package/perl-package-variant/Config.in
```kconfig
config BR2_PACKAGE_PERL_PACKAGE_VARIANT
	bool "perl-package-variant"
	select BR2_PACKAGE_PERL_IMPORT_INTO
	select BR2_PACKAGE_PERL_MODULE_RUNTIME
	select BR2_PACKAGE_PERL_STRICTURES
	help
	  Parameterizable packages

	  https://metacpan.org/release/Package-Variant
```

## package/perl-parse-recdescent/Config.in
```kconfig
config BR2_PACKAGE_PERL_PARSE_RECDESCENT
	bool "perl-parse-recdescent"
	depends on !BR2_STATIC_LIBS
	help
	  Generate Recursive-Descent Parsers

	  https://metacpan.org/release/Parse-RecDescent

comment "perl-parse-recdescent needs a toolchain w/ dynamic library"
	depends on BR2_STATIC_LIBS
```

## package/perl-path-class/Config.in
```kconfig
config BR2_PACKAGE_PERL_PATH_CLASS
	bool "perl-path-class"
	help
	  Cross-platform path specification manipulation

	  https://metacpan.org/release/Path-Class
```

## package/perl-scope-guard/Config.in
```kconfig
config BR2_PACKAGE_PERL_SCOPE_GUARD
	bool "perl-scope-guard"
	help
	  lexically-scoped resource management

	  https://metacpan.org/release/Scope-Guard
```

## package/perl-sql-abstract/Config.in
```kconfig
config BR2_PACKAGE_PERL_SQL_ABSTRACT
	bool "perl-sql-abstract"
	depends on !BR2_STATIC_LIBS
	select BR2_PACKAGE_PERL_HASH_MERGE
	select BR2_PACKAGE_PERL_MRO_COMPAT
	select BR2_PACKAGE_PERL_MOO
	help
	  Generate SQL from Perl data structures

	  https://metacpan.org/release/SQL-Abstract

comment "perl-sql-abstract needs a toolchain w/ dynamic library"
	depends on BR2_STATIC_LIBS
```

## package/perl-sql-translator/Config.in
```kconfig
config BR2_PACKAGE_PERL_SQL_TRANSLATOR
	bool "perl-sql-translator"
	depends on !BR2_STATIC_LIBS
	select BR2_PACKAGE_PERL_CARP_CLAN
	select BR2_PACKAGE_PERL_DBI
	select BR2_PACKAGE_PERL_FILE_SHAREDIR
	select BR2_PACKAGE_PERL_LIST_MOREUTILS
	select BR2_PACKAGE_PERL_MOO
	select BR2_PACKAGE_PERL_PACKAGE_VARIANT
	select BR2_PACKAGE_PERL_PARSE_RECDESCENT
	select BR2_PACKAGE_PERL_TRY_TINY
	help
	  SQL DDL transformations and more

	  https://metacpan.org/release/SQL-Translator

comment "perl-sql-translator needs a toolchain w/ dynamic library"
	depends on BR2_STATIC_LIBS
```

## package/perl-strictures/Config.in
```kconfig
config BR2_PACKAGE_PERL_STRICTURES
	bool "perl-strictures"
	help
	  turn on strict and make most warnings fatal

	  https://metacpan.org/release/strictures
```

## package/perl-sub-name/Config.in
```kconfig
config BR2_PACKAGE_PERL_SUB_NAME
	bool "perl-sub-name"
	depends on !BR2_STATIC_LIBS
	help
	  (Re)name a sub

	  https://github.com/p5sagit/Sub-Name

comment "perl-sub-name needs a toolchain w/ dynamic library"
	depends on BR2_STATIC_LIBS
```

## package/perl-xml-writer/Config.in
```kconfig
config BR2_PACKAGE_PERL_XML_WRITER
	bool "perl-xml-writer"
	help
	  Easily generate well-formed, namespace-aware XML.

	  https://metacpan.org/release/XML-Writer
```

## package/perl-yaml/Config.in
```kconfig
config BR2_PACKAGE_PERL_YAML
	bool "perl-yaml"
	help
	  YAML Ain't Markup Language™

	  https://github.com/ingydotnet/yaml-pm
```

## package/protobuf-c-rpc/Config.in
```kconfig
config BR2_PACKAGE_PROTOBUF_C_RPC
       select BR2_PACKAGE_PROTOBUF_C
       bool "protobuf-c-rpc"
```

## package/python-CVXcanon/Config.in
```kconfig
config BR2_PACKAGE_PYTHON_CVXCANON
	bool "python-CVXcanon"
        select BR2_PACKAGE_PYTHON_SCIPY
	help
	  A low-level library to perform the matrix building step in cvxpy, a convex optimization modeling software.
	  https://pypi.python.org/pypi/CVXcanon/0.1.1
```

## package/python-aenum/Config.in
```kconfig
config BR2_PACKAGE_PYTHON_AENUM
	bool "python-aenum"
	help
	  Python Package - Advanced Enumerations (compatible with Python's stdlib Enum), NamedTuples, and NamedConstants

	  https://pypi.org/project/aenum/
```

## package/python-aioes/Config.in
```kconfig
config BR2_PACKAGE_PYTHON_AIOES
	bool "python-aioes"
	depends on BR2_PACKAGE_PYTHON3
	depends on BR2_PACKAGE_PYTHON_AIOHTTP
	depends on BR2_PACKAGE_PYTHON_YARL
	help
	  Python Package - Elasticsearch integration with asyncio.

	  https://pypi.org/project/aioes/
```

## package/python-aiofiles/Config.in
```kconfig
config BR2_PACKAGE_PYTHON_AIOFILES
	bool "python-aiofiles"
	depends on BR2_PACKAGE_PYTHON3
	help
	  Python package - File support for asyncio

	  https://pypi.org/project/aiofiles/
```

## package/python-aiohttp-cors/Config.in
```kconfig
config BR2_PACKAGE_PYTHON_AIOHTTP_CORS
	bool "python-aiohttp-cors"
	depends on BR2_PACKAGE_PYTHON3
	depends on BR2_PACKAGE_PYTHON_AIOHTTP
	help
	  Python Package - CORS support for aiohttp

	  https://pypi.org/project/aiohttp_cors/
```

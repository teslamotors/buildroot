## package/python-aiohttp/Config.in
```kconfig
config BR2_PACKAGE_PYTHON_AIOHTTP
	bool "python-aiohttp"
	depends on BR2_PACKAGE_PYTHON3
	depends on BR2_PACKAGE_PYTHON_CHARDET
	depends on BR2_PACKAGE_PYTHON_MULTIDICT
	depends on BR2_PACKAGE_PYTHON_ASYNC_TIMEOUT
	depends on BR2_PACKAGE_PYTHON_YARL
	help
	  Python package - Async http client/server framework (asyncio)

	  https://pypi.org/project/aiohttp/
```

## package/python-altgraph/Config.in
```kconfig
config BR2_PACKAGE_PYTHON_ALTGRAPH
	bool "python-altgraph"
	help
	  Python Package - Python graph (network) package

	  https://pypi.org/project/altgraph/
```

## package/python-appdirs/Config.in
```kconfig
config BR2_PACKAGE_PYTHON_APPDIRS
	bool "python-appdirs"
	help
	  Python Package - A small Python module for determining appropriate platform-specific dirs, e.g. a "user data dir".

	  https://pypi.org/project/appdirs/
```

## package/python-async-generator/Config.in
```kconfig
config BR2_PACKAGE_PYTHON_ASYNC_GENERATOR
	bool "python-async-generator"
	depends on BR2_PACKAGE_PYTHON3
	help
	  Python Package - Async generators and context managers for Python 3.5+

	  https://pypi.org/project/async_generator/
```

## package/python-asyncio-extras/Config.in
```kconfig
config BR2_PACKAGE_PYTHON_ASYNCIO_EXTRAS
	bool "python-asyncio-extras"
	depends on BR2_PACKAGE_PYTHON3
	help
	  Python Package - Asynchronous generators, context managers and more for asyncio

	  https://pypi.org/project/asyncio_extras/
```

## package/python-asyncssh/Config.in
```kconfig
config BR2_PACKAGE_PYTHON_ASYNCSSH
	bool "python-asyncssh"
	depends on BR2_PACKAGE_PYTHON3
	depends on BR2_PACKAGE_PYTHON_CRYPTOGRAPHY
	help
	  Python Package - AsyncSSH: Asynchronous SSHv2 client and server library

	  https://pypi.org/project/asyncssh/
```

## package/python-attrdict/Config.in
```kconfig
config BR2_PACKAGE_PYTHON_ATTRDICT
	bool "python-attrdict"
	help
	  Python Package - A dict with attribute-style access

	  https://pypi.org/project/attrdict/
```

## package/python-bitarray/Config.in
```kconfig
config BR2_PACKAGE_PYTHON_BITARRAY
	bool "python-bitarray"
	help
	  Python Library - efficient arrays of booleans -- C extension

	  https://pypi.org/project/bitarray/
```

## package/python-blinker/Config.in
```kconfig
config BR2_PACKAGE_PYTHON_BLINKER
	bool "python-blinker"
	help
	  Python Package - Fast, simple object-to-object and broadcast signaling

	  https://pypi.org/project/blinker/
```

## package/python-cachetools/Config.in
```kconfig
config BR2_PACKAGE_PYTHON_CACHETOOLS
	bool "python-cachetools"
	help
	  Extensible memoizing collections and decorators

	  https://pypi.org/project/cachetools/
```

## package/python-cattrs/Config.in
```kconfig
config BR2_PACKAGE_PYTHON_CATTRS
	bool "python-cattrs"
	select BR2_PACKAGE_PYTHON_ATTRS # runtime
	help
	  Composable complex class support for attrs and dataclasses.

	  https://github.com/Tinche/cattrs
```

## package/python-cvxopt/Config.in
```kconfig
config BR2_PACKAGE_PYTHON_CVXOPT
        bool "python-cvxopt"
        help
          CVXOPT is a free software package for convex optimization based on the 
          Python programming language.

          http://cvxopt.org
```

## package/python-cvxpy/Config.in
```kconfig
config BR2_PACKAGE_PYTHON_CVXPY
	bool "python-cvxpy"
        select BR2_PACKAGE_HOST_PYTHON_NUMPY
        select BR2_PACKAGE_PYTHON_NUMPY
        select BR2_PACKAGE_PYTHON_CVXCANON
	select BR2_PACKAGE_PYTHON_MULTIPROCESS
        select BR2_PACKAGE_PYTHON_SCIPY
        select BR2_PACKAGE_PYTHON_TOOLZ
        select BR2_PACKAGE_PYTHON_SCS
        select BR2_PACKAGE_OPENBLAS
	help
	  A domain-specific language for modeling convex optimization problems in Python

	  https://pypi.python.org/pypi/cvxpy
```

## package/python-cylp/Config.in
```kconfig
config BR2_PACKAGE_PYTHON_CYLP
	bool "python-cylp"
        select BR2_PACKAGE_PYTHON_NUMPY
        select BR2_PACKAGE_PYTHON_SCIPY
	depends on BR2_PACKAGE_LIBCBC
	help
	  A Python interface to CLP, CBC, and CGL to solve LPs and MIPs.

	  https://pypi.python.org/pypi/cylp
```

## package/python-dataclasses/Config.in
```kconfig
config BR2_PACKAGE_PYTHON_DATACLASSES
	bool "python-dataclasses"
	help
	  A backport of the dataclasses module for Python 3.6.

	  https://github.com/ericvsmith/dataclasses
```

## package/python-dbus-next/Config.in
```kconfig
config BR2_PACKAGE_PYTHON_DBUS_NEXT
	bool "python-dbus-next"
	help
	  Python DBus library with asyncio support

	  https://github.com/altdesktop/python-dbus-next
```

## package/python-dill/Config.in
```kconfig
config BR2_PACKAGE_PYTHON_DILL
	bool "python-dill"
	help
	  serialize all of python.

	  http://www.cacr.caltech.edu/~mmckerns/dill.htm
```

## package/python-dotted/Config.in
```kconfig
config BR2_PACKAGE_PYTHON_DOTTED
	bool "python-dotted"
	help
	  Access dicts and lists with a dotted path notation.

	  https://pypi.org/project/dotted/
```

## package/python-ecos/Config.in
```kconfig
config BR2_PACKAGE_PYTHON_ECOS
       bool "python-ecos"
       select BR2_PACKAGE_HOST_PYTHON_NUMPY
       select BR2_PACKAGE_PYTHON_NUMPY
       select BR2_PACKAGE_PYTHON_SCIPY
       help
         Python package for ECOS: Embedded Cone Solver.

         http://github.com/embotech/ecos
```

## package/python-fastcache/Config.in
```kconfig
config BR2_PACKAGE_PYTHON_FASTCACHE
	bool "python-fastcache"
	help
	  C implementation of Python 3 functools.lru_cache.
	  http://pypi.python.org/pypi/fastcache/
```

## package/python-functools32/Config.in
```kconfig
config BR2_PACKAGE_PYTHON_FUNCTOOLS32
	bool "python-functools32"
	help
	  Backport of the functools module from Python 3.2.3 for use on 2.7.
	  http://pypi.python.org/pypi/functools32
```

## package/python-future/Config.in
```kconfig
config BR2_PACKAGE_PYTHON_FUTURE
	bool "python-future"
	help
	  Python Package -　Clean single-source support for Python 3 and 2

	  https://pypi.org/project/future/
```

## package/python-gitdb2/Config.in
```kconfig
config BR2_PACKAGE_PYTHON_GITDB2
	bool "python-gitdb2"
	help
	  Python Package - Git Object Database

	  https://pypi.org/project/gitdb2/
```

## package/python-gitpython/Config.in
```kconfig
config BR2_PACKAGE_PYTHON_GITPYTHON
	bool "python-gitpython"
	depends on BR2_PACKAGE_PYTHON_GITDB2
	help
	  Python Package - Python Git Library

	  https://pypi.org/project/GitPython/
```

## package/python-importlib-metadata/Config.in
```kconfig
config BR2_PACKAGE_PYTHON_IMPORTLIB_METADATA
	bool "python-importlib-metadata"
	help
        importlib_metadata is a library to access the metadata for a Python package.
        It is intended to be ported to Python 3.8.
```

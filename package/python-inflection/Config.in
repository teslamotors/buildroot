## package/python-inflection/Config.in
```kconfig
config BR2_PACKAGE_PYTHON_INFLECTION
	bool "python-inflection"
	help
	  Python Package - A port of Ruby on Rails inflector to Python

	  https://pypi.org/project/inflection/
```

## package/python-mock/Config.in
```kconfig
config BR2_PACKAGE_PYTHON_MOCK
	bool "python-mock"
	depends on BR2_PACKAGE_PYTHON_PBR
	depends on BR2_PACKAGE_PYTHON_SIX
	help
	  Python Package - Rolling backport of unittest.mock for all Pythons

	  https://pypi.org/project/mock/
```

## package/python-multiprocess/Config.in
```kconfig
config BR2_PACKAGE_PYTHON_MULTIPROCESS
	bool "python-multiprocess"
	help
	   better multiprocessing and multithreading in python
	   https://pypi.python.org/pypi/multiprocess
```

## package/python-nose/Config.in
```kconfig
config BR2_PACKAGE_PYTHON_NOSE
	bool "python-nose"
	help
	  nose extends unittest to make testing easier
	  https://pypi.python.org/pypi/nose
```

## package/python-pandas/Config.in
```kconfig
config BR2_PACKAGE_PYTHON_PANDAS
	bool "python-pandas"
	select BR2_PACKAGE_PYTHON3_BZIP2
	select BR2_PACKAGE_PYTHON3_XZ
	help
	  Powerful data structures for data analysis, time series,and statistics
	  https://pypi.python.org/pypi/pandas
```

## package/python-pbr/Config.in
```kconfig
config BR2_PACKAGE_PYTHON_PBR
	bool "python-pbr"
	help
	  Python Package - Python Build Reasonableness

	  https://pypi.org/project/pbr/
```

## package/python-pika/Config.in
```kconfig
config BR2_PACKAGE_PYTHON_PIKA
	bool "python-pika"
	depends on BR2_PACKAGE_PYTHON_TORNADO
	depends on BR2_PACKAGE_PYTHON_TWISTED
	help
	  Python Package - Pika Python AMQP Client Library

	  https://pypi.org/project/pika/
```

## package/python-plotly/Config.in
```kconfig
config BR2_PACKAGE_PYTHON_PLOTLY
	bool "python-plotly"
	select BR2_PACKAGE_PYTHON_REQUESTS
	help
	  Python plotting library for collaborative, interactive, publication-quality graphs.

	  https://plot.ly/
```

## package/python-pluggy/Config.in
```kconfig
config BR2_PACKAGE_PYTHON_PLUGGY
	bool "python-pluggy"
	help
	  Python Package - plugin and hook calling mechanisms for python

	  https://pypi.org/project/pluggy/
```

## package/python-pvlib/Config.in
```kconfig
config BR2_PACKAGE_PYTHON_PVLIB
	bool "python-pvlib"
	select BR2_PACKAGE_PYTHON_NUMPY # runtime
	select BR2_PACKAGE_PYTHON_PANDAS # runtime
	select BR2_PACKAGE_PYTHON_PYTZ # runtime
	# Don't actually want to be able to download data on-device
	# select BR2_PACKAGE_PYTHON_REQUESTS # runtime
	select BR2_PACKAGE_PYTHON_SCIPY # runtime
	help
	  A set of functions and classes for simulating the
	  performance of photovoltaic energy systems.

	  https://github.com/pvlib/pvlib-python
```

## package/python-pyjwt/Config.in
```kconfig
config BR2_PACKAGE_PYTHON_PYJWT
	bool "python-pyjwt"
	depends on BR2_PACKAGE_PYTHON3
	depends on BR2_PACKAGE_PYTHON_CRYPTOGRAPHY
	help
	  JSON Web Token implementation in Python.

	  http://github.com/jpadilla/pyjwt
```

## package/python-pyomo/Config.in
```kconfig
config BR2_PACKAGE_PYTHON_PYOMO
	bool "python-pyomo"
	help
	  Pyomo is a Python-based open-source software package that supports a
	  diverse set of optimization capabilities for formulating, solving, and
	  analyzing optimization models.
```

## package/python-pypng/Config.in
```kconfig
config BR2_PACKAGE_PYTHON_PYPNG
	bool "python-pypng"
	help
	  Python Package - Pure Python PNG image encoder/decoder

	  https://pypi.org/project/pypng/
```

## package/python-pytest/Config.in
```kconfig
config BR2_PACKAGE_PYTHON_PYTEST
        bool "python-pytest"
        help
          The pytest framework makes it easy to write small tests, yet scales to support complex functional testing for applications and libraries.
          http://pypi.python.org/pypi/pytest
```

## package/python-pyutilib/Config.in
```kconfig
config BR2_PACKAGE_PYTHON_PYUTILIB
	bool "python-PyUtilib"
	select BR2_PACKAGE_PYTHON_NOSE
	select BR2_PACKAGE_PYTHON_SIX
	help
	  The PyUtilib project supports a collection of Python utilities,
	  including a well-developed component architecture and extensions to the
	  PyUnit testing framework. PyUtilib has been developed to support several
	  Python-centric projects, especially Pyomo.
```

## package/python-scipy/Config.in
```kconfig
config BR2_PACKAGE_PYTHON_SCIPY
	bool "python-scipy"
        select BR2_PACKAGE_PYTHON_NUMPY
        select BR2_PACKAGE_OPENBLAS
        select BR2_PACKAGE_CLAPACK
	help
	  SciPy -- Scientific Library for Python

	  https://www.scipy.org
```

## package/python-scs/Config.in
```kconfig
config BR2_PACKAGE_PYTHON_SCS
       bool "python-scs"
       help
         SCS (splitting conic solver) is a numerical optimization package for solving large-scale convex cone problems

         https://github.com/cvxgrp/scs
```

## package/python-smmap2/Config.in
```kconfig
config BR2_PACKAGE_PYTHON_SMMAP2
	bool "python-smmap2"
	help
	  Python Package - A pure Python implementation of a sliding window memory map manager

	  https://pypi.org/project/smmap2/
```

## package/python-telnetlib3/Config.in
```kconfig
config BR2_PACKAGE_PYTHON_TELNETLIB3
	bool "python-telnetlib3"
	depends on BR2_PACKAGE_PYTHON3
	help
	  Python Package - Python 3 asyncio Telnet server and client Protocol library

	  https://pypi.org/project/telnetlib3/
```

## package/python-toolz/Config.in
```kconfig
config BR2_PACKAGE_PYTHON_TOOLZ
        bool "python-toolz"
        help
          A set of utility functions for iterators, functions, and dictionaries.
          http://pypi.python.org/pypi/toolz/
```

## package/python-yarl/Config.in
```kconfig
config BR2_PACKAGE_PYTHON_YARL
	bool "python-yarl"
	depends on BR2_PACKAGE_PYTHON3
	depends on BR2_PACKAGE_PYTHON_MULTIDICT
	help
	  Python Package - Yet another URL library

	  https://pypi.org/project/yarl/
```

## package/python-zipp/Config.in
```kconfig
config BR2_PACKAGE_PYTHON_ZIPP
	bool "python-zipp"
	help
        A pathlib-compatible Zipfile object wrapper. A backport of the Path object.
```

## package/qpoases-e/Config.in
```kconfig
config BR2_PACKAGE_QPOASES_E
       bool "QPOASES"
       help
         qpOASES embedded - This is an almost complete plain C, static memory
         translation of qpOASES 3.1 from February 2015

         https://projects.coin-or.org/qpOASES/wiki/QpoasesEmbedded
```

## package/runit/Config.in
```kconfig
config BR2_PACKAGE_RUNIT
       bool "runit"
       select BR2_INIT_NONE
       help
         Runit - a UNIX init scheme with service supervision

         http://smarden.org/runit/

if BR2_PACKAGE_RUNIT
config BR2_PACKAGE_RUNIT_INIT
       bool "runit-init"
       default "y"
       help
         Install a symlink from /sbin/init to /sbin/runit-init,
         making runit-init the init for the system
endif
```

## package/shadow/Config.in
```kconfig
config BR2_PACKAGE_SHADOW
       bool "shadow"
       help
         Password utilities

         https://github.com/shadow-maint/shadow
```

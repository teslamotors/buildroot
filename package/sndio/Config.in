## package/sndio/Config.in
```kconfig
config BR2_PACKAGE_SNDIO
	bool "sndio"
	select BR2_PACKAGE_ALSA_LIB
	help
	  Sndio is a small audio and MIDI framework. It provides a lightweight audio & MIDI server and a fully documented user-space API to access either the server or directly the hardware in a uniform way.
```

## package/sqlite/Config.in
```kconfig
config BR2_PACKAGE_SQLITE
	bool "sqlite"
	help
	  SQLite is a small C library that implements a
	  self-contained, embeddable, zero-configuration SQL database
	  engine.

	  http://www.sqlite.org/

if BR2_PACKAGE_SQLITE

config BR2_PACKAGE_SQLITE_MAX_PAGE_COUNT
	bool "Maximum database size (in 1KB pages)"
	default 1073741823
	help
	  SQLite is able to limit the size of a database file to prevent
	  the database file from growing too large and consuming too
	  much disk space. The SQLITE_MAX_PAGE_COUNT parameter, which
	  is normally set to 1073741823, is the maximum number of pages
	  allowed in a single database file. An attempt to insert new
	  data that would cause the database file to grow larger than
	  this will return SQLITE_FULL.

	  The largest possible setting for SQLITE_MAX_PAGE_COUNT is
	  2147483646. When used with the maximum page size of 65536, this
	  gives a maximum SQLite database size of about 140 terabytes.

config BR2_PACKAGE_SQLITE_RTREE
	bool "Enable SQLite R*Tree module"
	default n
	help
	  An R-Tree is a special index that is designed for doing range
	  queries. R-Trees are most commonly used in geospatial systems
	  where each entry is a rectangle with minimum and maximum X
	  and Y coordinates.

config BR2_PACKAGE_SQLITE_MEMSYS5
	bool "Include memsys5 allocator in build"
	default n
	help
	  When SQLite is compiled with the SQLITE_ENABLE_MEMSYS5 option,
	  an alternative memory allocator that does not use malloc()
	  is included in the build.

	  The memsys5 allocator is designed for use on embedded systems,
	  though there is nothing to prevent its use on workstations.

config BR2_PACKAGE_SQLITE_STAT3
	bool "Additional query optimizations (stat3)"
	help
	  Adds additional logic to the ANALYZE command and to the
	  query planner that can help SQLite to choose a better query
	  plan under certain situations.

config BR2_PACKAGE_SQLITE_ENABLE_COLUMN_METADATA
	bool "Enable convenient access to meta-data about tables and queries"
	help
	  When this option is defined there are some additional APIs
	  enabled to acces meta-data about tables and queries (see
	  https://sqlite.org/compile.html).

config BR2_PACKAGE_SQLITE_ENABLE_FTS3
	bool "Enable version 3 of the full-text search engine"
	help
	  When this option is defined in the amalgamation (see
	  http://www.sqlite.org/amalgamation.html), version 3 of the
	  full-text search engine is added to the build automatically.

config BR2_PACKAGE_SQLITE_ENABLE_JSON1
	bool "Enable the JSON extensions for SQLite"
	help
	  When this option is defined in the amalgamation, the JSON
	  extensions are added to the build automatically.

config BR2_PACKAGE_SQLITE_ENABLE_UNLOCK_NOTIFY
	bool "Enable sqlite3_unlock_notify() interface"
	help
	  This option enables the sqlite3_unlock_notify() interface
	  and its accosiated functionality. See the documentation
	  http://www.sqlite.org/unlock_notify.html for additional
	  information.

config BR2_PACKAGE_SQLITE_SECURE_DELETE
	bool "Set the secure_delete pragma on by default"
	help
	  This compile-time option changes the default settings of the
	  secure_delete pragma. When this option is not used,
	  secure_delete defaults to off. When this option is present,
	  secure_delete defaults to on.

	  The secure_delete setting causes deleted content to be
	  overwritten with zeros. There is a small performance penalty
	  for this since additional I/O must occur. On the other hand,
	  secure_delete can prevent sensitive information from
	  lingering in unused parts of the database file after it has
	  allegedly been deleted. See the documentation on the
	  http://www.sqlite.org/pragma.html#pragma_secure_delete for
	  additional information.

config BR2_PACKAGE_SQLITE_NO_SYNC
	bool "Disable fsync"
	help
	  By default SQLite forces all database transactions to
	  storage immediately using fsync() to protect against data
	  loss in case of power failure. This option turns this
	  behavior off resulting in higher performance especially when
	  using slow flash storage.

endif
```

## package/suitesparse/Config.in
```kconfig
config BR2_PACKAGE_SUITESPARSE
       bool "suitesparse"
       depends on BR2_PACKAGE_METIS
       help
         A suite of sparse matrix algorithms

         http://faculty.cse.tamu.edu/davis/suitesparse.html
```

## package/tesla-avb-boost/Config.in
```kconfig
comment "boost needs a toolchain w/ C++, threads, wchar"
	depends on !BR2_INSTALL_LIBSTDCPP || !BR2_TOOLCHAIN_HAS_THREADS || !BR2_USE_WCHAR

config BR2_PACKAGE_TESLA_AVB_BOOST_ARCH_SUPPORTS
	bool
	default y if !BR2_TOOLCHAIN_EXTERNAL_CODESOURCERY_NIOSII

config BR2_PACKAGE_TESLA_AVB_BOOST
	bool "tesla_avb_boost"
	depends on BR2_INSTALL_LIBSTDCPP
	depends on BR2_PACKAGE_TESLA_AVB_BOOST_ARCH_SUPPORTS
	# Tesla_Avb_Boost could theorically be built with threading=single, but
	# that unfortunately doesn't work. Until someone fixes that,
	# let's depend on threads.
	depends on BR2_TOOLCHAIN_HAS_THREADS
	depends on BR2_USE_WCHAR
	help
	  Contortions to supply the specific version of Boost that are
	  required by the Intel AVB binaries that we are using.

	  http://www.boost.org/

if BR2_PACKAGE_TESLA_AVB_BOOST
config BR2_PACKAGE_TESLA_AVB_BOOST_INSTALL_PREFIX
	string "install prefix"
	default "/opt/tesla-avb-boost"
	help
	  Selects the target install directory prefix for Tesla AVB Boost libraries

choice
	prompt "Layout"
	default BR2_PACKAGE_TESLA_AVB_BOOST_LAYOUT_SYSTEM
	help
	  Selects the layout of Tesla_Avb_Boost binary names

config BR2_PACKAGE_TESLA_AVB_BOOST_LAYOUT_SYSTEM
	bool "system"
	help
	  Tesla_Avb_Boost binary names do not include the Tesla_Avb_Boost version number
	  or the name and version number of the compiler.

config BR2_PACKAGE_TESLA_AVB_BOOST_LAYOUT_TAGGED
	bool "tagged"
	help
	  Tesla_Avb_Boost binary names include the encoded build properties such
	  as variant and threading, but do not include compiler name
	  and version, or Tesla_Avb_Boost version. This option is useful if you
	  build several variants of Tesla_Avb_Boost, using the same compiler.

config BR2_PACKAGE_TESLA_AVB_BOOST_LAYOUT_VERSIONED
	bool "versioned"
	help
	  Tesla_Avb_Boost binary names include the Tesla_Avb_Boost version number, name
	  and version of the compiler and encoded build properties.

endchoice

config BR2_PACKAGE_TESLA_AVB_BOOST_LAYOUT
	string
	default "system" if BR2_PACKAGE_TESLA_AVB_BOOST_LAYOUT_SYSTEM
	default "tagged" if BR2_PACKAGE_TESLA_AVB_BOOST_LAYOUT_TAGGED
	default "versioned" if BR2_PACKAGE_TESLA_AVB_BOOST_LAYOUT_VERSIONED

config BR2_PACKAGE_TESLA_AVB_BOOST_ATOMIC
	bool "tesla_avb_boost-atomic"

config BR2_PACKAGE_TESLA_AVB_BOOST_CHRONO
	bool "tesla_avb_boost-chrono"

config BR2_PACKAGE_TESLA_AVB_BOOST_CONTAINER
	bool "tesla_avb_boost-container"

# see
# http://www.boost.org/doc/libs/1_59_0/libs/context/doc/html/context/architectures.html
# for the list of supported architectures. Sparc pretends to be
# supported, but it doesn't build.
config BR2_PACKAGE_TESLA_AVB_BOOST_CONTEXT
	bool "tesla_avb_boost-context"
	depends on (BR2_arm || BR2_armeb || BR2_i386 || BR2_mips || BR2_mipsel \
			|| BR2_powerpc || BR2_x86_64)

config BR2_PACKAGE_TESLA_AVB_BOOST_COROUTINE
	bool "tesla_avb_boost-coroutine"
	depends on BR2_PACKAGE_TESLA_AVB_BOOST_CONTEXT

config BR2_PACKAGE_TESLA_AVB_BOOST_COROUTINE2
	bool "tesla_avb_boost-coroutine2"
	depends on BR2_PACKAGE_TESLA_AVB_BOOST_CONTEXT

config BR2_PACKAGE_TESLA_AVB_BOOST_DATE_TIME
	bool "tesla_avb_boost-date_time"

config BR2_PACKAGE_TESLA_AVB_BOOST_EXCEPTION
	bool "tesla_avb_boost-exception"

config BR2_PACKAGE_TESLA_AVB_BOOST_FILESYSTEM
	bool "tesla_avb_boost-filesystem"

config BR2_PACKAGE_TESLA_AVB_BOOST_GRAPH
	bool "tesla_avb_boost-graph"

config BR2_PACKAGE_TESLA_AVB_BOOST_GRAPH_PARALLEL
	bool "tesla_avb_boost-graph_parallel"

config BR2_PACKAGE_TESLA_AVB_BOOST_IOSTREAMS
	bool "tesla_avb_boost-iostreams"
	select BR2_PACKAGE_BZIP2
	select BR2_PACKAGE_ZLIB

config BR2_PACKAGE_TESLA_AVB_BOOST_LOCALE
	bool "tesla_avb_boost-locale"
	select BR2_PACKAGE_LIBICONV if !BR2_ENABLE_LOCALE

config BR2_PACKAGE_TESLA_AVB_BOOST_LOG
	bool "tesla_avb_boost-log"
	depends on BR2_TOOLCHAIN_HAS_THREADS_NPTL
	# for some reason, uClibc on PowerPC fails to build the tesla_avb_boost
	# log module
	depends on !(BR2_powerpc && BR2_TOOLCHAIN_USES_UCLIBC)

comment "tesla_avb_boost-log needs a toolchain w/ NPTL"
	depends on !BR2_TOOLCHAIN_HAS_THREADS_NPTL
	depends on !(BR2_powerpc && BR2_TOOLCHAIN_USES_UCLIBC)

config BR2_PACKAGE_TESLA_AVB_BOOST_MATH
	bool "tesla_avb_boost-math"

config BR2_PACKAGE_TESLA_AVB_BOOST_MPI
	bool "tesla_avb_boost-mpi"

config BR2_PACKAGE_TESLA_AVB_BOOST_PROGRAM_OPTIONS
	bool "tesla_avb_boost-program_options"

config BR2_PACKAGE_TESLA_AVB_BOOST_PYTHON
	depends on BR2_PACKAGE_PYTHON || BR2_PACKAGE_PYTHON3
	bool "tesla_avb_boost-python"

config BR2_PACKAGE_TESLA_AVB_BOOST_RANDOM
	bool "tesla_avb_boost-random"

config BR2_PACKAGE_TESLA_AVB_BOOST_REGEX
	bool "tesla_avb_boost-regex"

config BR2_PACKAGE_TESLA_AVB_BOOST_SERIALIZATION
	bool "tesla_avb_boost-serialization"

config BR2_PACKAGE_TESLA_AVB_BOOST_SIGNALS
	bool "tesla_avb_boost-signals"

config BR2_PACKAGE_TESLA_AVB_BOOST_SYSTEM
	bool "tesla_avb_boost-system"

config BR2_PACKAGE_TESLA_AVB_BOOST_TEST
	bool "tesla_avb_boost-test"
	depends on BR2_USE_MMU # fork()

config BR2_PACKAGE_TESLA_AVB_BOOST_THREAD
	bool "tesla_avb_boost-thread"

config BR2_PACKAGE_TESLA_AVB_BOOST_TIMER
	bool "tesla_avb_boost-timer"

config BR2_PACKAGE_TESLA_AVB_BOOST_WAVE
	bool "tesla_avb_boost-wave"

endif
```

## package/tesla-binutils/Config.in.host
```kconfig
config BR2_HOST_TESLA_BINUTILS
       bool "tesla binutils"
       help
         The buildroot host-binutils actually builds a cross-binutils.  This is binutils for the host system.
```

## package/tesla-gzip/Config.in
```kconfig
config BR2_PACKAGE_TESLA_GZIP
	bool "tesla-gzip"
	depends on BR2_USE_WCHAR
	help
	  Standard GNU compressor. Provides things like gzip,
	  gunzip, gzcat, etc...

	  http://www.gnu.org/software/gzip/gzip.html

comment "gzip needs a toolchain w/ wchar"
	depends on !BR2_USE_WCHAR
```

## package/tesla-libsystemd/Config.in
```kconfig
config BR2_PACKAGE_TESLA_LIBSYSTEMD
	bool "tesla-libsystemd"
	help
          tesla-libsystemd only exists to satisfy some link
          dependencies that the Intel AVB libraries have.  The code
          doesn't actually get run.
```

## package/tesla-nanomsg/Config.in
```kconfig
config BR2_PACKAGE_TESLA_NANOMSG
       bool "tesla-nanomsg"
       help
          Nanomsg socket library providing several common communication patterns and transport
```

## package/tesla-python-dateutil/Config.in
```kconfig
config BR2_PACKAGE_TESLA_PYTHON_DATEUTIL
        bool "tesla-python-dateutil"
        help
          The dateutil module provides powerful extensions to the datetime module available in the Python standard library.
          https://pypi.python.org/pypi/python-dateutil
```

## package/tesla-python-jsonschema/Config.in
```kconfig
config BR2_PACKAGE_TESLA_PYTHON_JSONSCHEMA
	bool "tesla-python-jsonschema"
	help
	  An implementation of JSON Schema validation for Python.
	  http://pypi.python.org/pypi/jsonschema
```

## package/tesla-python-pytz/Config.in
```kconfig
config BR2_PACKAGE_TESLA_PYTHON_PYTZ
        bool "tesla-python-pytz"
        help
          pytz - World Timezone Definitions for Python

          https://pypi.python.org/pypi/pytz/
```

## package/tesla-rsync/Config.in
```kconfig
config BR2_PACKAGE_TESLA_RSYNC
	bool "tesla-rsync"
	# fork()
	depends on BR2_USE_MMU
	select BR2_PACKAGE_ZLIB
	select BR2_PACKAGE_POPT
	help
	  File transfer program to keep remote files in sync.

	  http://rsync.samba.org/
```

## package/tesla-verity/Config.in
```kconfig
config BR2_PACKAGE_TESLA_VERITY
       bool "Tesla verity init"
       select BR2_PACKAGE_OPENSSL
       select BR2_PACKAGE_LVM2
       help
         Tesla-specific target init program for authenticating and mounting verity images

if BR2_PACKAGE_TESLA_VERITY
choice
        prompt "Target system"
        default BR2_PACKAGE_TESLA_VERITY_AP_HW2
        help
          Select the target system.

config BR2_PACKAGE_TESLA_VERITY_AP_HW2
       bool "ap-hw2"
       help
         Autopilot HW2 and HW2.5.

config BR2_PACKAGE_TESLA_VERITY_AP_HW3
       bool "ap-hw3"
       help
         Autopilot HW3

config BR2_PACKAGE_TESLA_VERITY_ICE_MRB
       bool "ice-mrb"
       select BR2_PACKAGE_LIBHECI
       help
         Infotainment system.

endchoice
endif
```

## package/tesla-which/Config.in
```kconfig
config BR2_PACKAGE_TESLA_WHICH
	bool "tesla-which"
	help
	  The standard 'which' utility.

	  http://www.xs4all.nl/~carlo17/which/
```

## package/tpm2-tss-engine/Config.in
```kconfig
config BR2_PACKAGE_TPM2_TSS_ENGINE
	bool "tpm2-tss-engine"
	depends on BR2_PACKAGE_OPENSSL
	select BR2_PACKAGE_TPM2_TSS
	help
	The tpm2-tss-engine project implements an OpenSSL engine for the 
	Trusted Platform Module (TPM) 2.0 using the tpm2-tss software stack 
	that follows the Trusted Computing Groups (TCG) TPM Software Stack 
	(TSS 2.0).

	https://github.com/tpm2-software/tpm2-tss-engine
```

## package/upstart/Config.in
```kconfig
config BR2_PACKAGE_UPSTART
       bool "upstart"
       select BR2_PACKAGE_EUDEV
       select BR2_PACKAGE_LIBNIH
       select BR2_PACKAGE_JSON_C
       select BR2_PACKAGE_DBUS
       help
         Upstart is Ubuntu's now-abandonded init system.
```

## package/ureadahead/Config.in
```kconfig
config BR2_PACKAGE_UREADAHEAD
	bool "ureadhead"
	depends on BR2_PACKAGE_LIBNIH
	help
         über-readahead is used during boot to read files in advance of when
         they are needed such that they are already in the page cache,
         improving boot performance.

         https://launchpad.net/ureadahead/
```

## package/vsomeip/Config.in
```kconfig
config BR2_PACKAGE_VSOMEIP
       bool "SOME/IP"
       select BR2_PACKAGE_BOOST_SYSTEM
       select BR2_PACKAGE_BOOST_THREAD
       select BR2_PACKAGE_BOOST_LOG
       select BR2_PACKAGE_BOOST
       select BR2_INSTALL_LIBSTDCPP
       select BR2_USE_WCHAR
       help
         An implementation of Scalable service-Oriented MiddlewarE over IP

         https://github.com/GENIVI/vsomeip/
         http://some-ip.com
```

## package/widevine/Config.in
```kconfig
menuconfig BR2_PACKAGE_WIDEVINE
	bool "widevine"
	depends on BR2_i386 || BR2_x86_64
	help
	  Proprietary content decryption module (CDM) for the digital
	  rights management (DRM) of internet content.
```

## package/x11r7/xdriver_xf86-input-evdev/Config.in
```kconfig
config BR2_PACKAGE_XDRIVER_XF86_INPUT_EVDEV
	bool "xf86-input-evdev"
	depends on BR2_PACKAGE_HAS_UDEV # libudev is configure dependency
	select BR2_PACKAGE_LIBEVDEV
	select BR2_PACKAGE_MTDEV
	select BR2_PACKAGE_XORGPROTO
	help
	  Generic Linux input driver

if BR2_PACKAGE_XDRIVER_XF86_INPUT_EVDEV

choice
	prompt "xf86-input-evdev version"
	default BR2_PACKAGE_XDRIVER_XF86_INPUT_EVDEV_VERSION_UPSTREAM
	help
	  Version of xf86-input-evdev to use

config BR2_PACKAGE_XDRIVER_XF86_INPUT_EVDEV_VERSION_UPSTREAM
	bool "Upstream buildroot version"
	help
	  Choose this version.

config BR2_PACKAGE_XDRIVER_XF86_INPUT_EVDEV_2_3_2
	bool "Version 2.3.2"
	help
	  This version corresponds to Ubuntu 10.x and is needed when
	  building xserver 1.9.0

config BR2_PACKAGE_XDRIVER_XF86_INPUT_EVDEV_2_7_0
	bool "Version 2.7.0"
	help
	  This version corresponds to Ubuntu 12.04 and is needed when
	  building xserver 1.11.4

endchoice

endif

comment "xf86-input-evdev requires udev to be enabled"
	depends on !BR2_PACKAGE_HAS_UDEV
```
